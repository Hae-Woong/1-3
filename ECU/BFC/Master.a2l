/***********************************************************************************************************************
| Description: Project specific master A2L file. The file may need to be adapted in order to match the ECU configuration
| C O P Y R I G H T
| Copyright by Vector Informatik GmbH. All rights reserved.
| This software is copyright protected and proprietary to
| Vector Informatik GmbH. Vector Informatik GmbH grants to you
| only those rights as set out in the license conditions. All
| other rights remain with Vector Informatik GmbH.
| A U T H O R I D E N T I T Y
| Initials Name Company
| Hs Hannes Haas Vector Informatik GmbH
| R E V I S I O N H I S T O R Y
| Date Version Author Description
| 2012-11-23 1.00.00 Hs Creation
| 2020-03-23 1.01.00 Hr Added CANAPE_ADDRESS_UPDATE
| 2021-08-10 2.00.00 Hr Replaced 1.2 AML by 1.4 AML
| ESCAN00107626 a2l: Support XCPplus instead of XCP
|*********************************************************************************************************************/ ASAP2_VERSION 1 70
/begin PROJECT MICROSAR ""
/begin MODULE CPP ""
/begin MOD_COMMON "" BYTE_ORDER MSB_LAST /* TODO: Please configure the byte alignment used in this project */ ALIGNMENT_BYTE 1 /* ALIGNMENT_WORD 2 */ /* ALIGNMENT_LONG 4 */ /* ALIGNMENT_INT64 8 */ /* ALIGNMENT_FLOAT32_IEEE 4 */ /* ALIGNMENT_FLOAT64_IEEE 8 */ /end MOD_COMMON
/begin MOD_PAR "" /* TODO: Add or include MEMORY_SEGMENT information here */ /end MOD_PAR
/* TODO: Add or include further a2l splitter that provide measurement objects */
/end MODULE
/end PROJECT
