AUTOSAR XML (schema 00049)
package /COM/VECTOR/CFG/WORKFLOW/SYSDESC/SYNC
  flat map FLATMAP
    5 x flat instance descriptor:
      Output: upstream-reference=ECU_Composition.Output, ecu-extract-reference=COMPOSITIONTYPE.Output
      Input: upstream-reference=ECU_Composition.Input, ecu-extract-reference=COMPOSITIONTYPE.Input
      BSW_Handler: upstream-reference=ECU_Composition.BSW_Handler, ecu-extract-reference=COMPOSITIONTYPE.BSW_Handler
      IoHwAb: upstream-reference=ECU_Composition.IoHwAb, ecu-extract-reference=COMPOSITIONTYPE.IoHwAb
      LightCtrl: upstream-reference=ECU_Composition.LightCtrl, ecu-extract-reference=COMPOSITIONTYPE.LightCtrl
