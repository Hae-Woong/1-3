AUTOSAR XML (schema 00049)
package /InitialEcuC
  ecuc value collection InitialEcuC: ecuc-values=[Dcm, Dem]
  module config Dcm: module-description=Dcm_Impl
    DcmConfigSet
      DcmGeneral: DcmResetToFblAfterSessionFinalResponseEnabled=false
      DcmDsd
        DcmDsdServiceTable
          15 x DcmDsdService:
            DiagSessionControl: DcmDsdSidTabServiceId=16, DcmDsdSidTabSubfuncAvail=true
              3 x DcmDsdSubService:
                Default: DcmDsdSubServiceId=1
                Programming: DcmDsdSubServiceId=2
                Extended: DcmDsdSubServiceId=3
            EcuReset: DcmDsdSidTabServiceId=17, DcmDsdSidTabSubfuncAvail=true
              Hard (DcmDsdSubService): DcmDsdSubServiceId=1
            ClearDiagInfo: DcmDsdSidTabServiceId=20, DcmDsdSidTabSubfuncAvail=false
            ReadDtcInfo: DcmDsdSidTabServiceId=25, DcmDsdSidTabSubfuncAvail=true
              12 x DcmDsdSubService:
                RNODTCBSM: DcmDsdSubServiceId=1
                RDTCBSM: DcmDsdSubServiceId=2
                RDTCSSI: DcmDsdSubServiceId=3
                RDTCSSBDTC: DcmDsdSubServiceId=4
                RDTCEDRBDN: DcmDsdSubServiceId=6
                RNODTCBSMR: DcmDsdSubServiceId=7
                RDTCBSMR: DcmDsdSubServiceId=8
                RSIODTC: DcmDsdSubServiceId=9
                RSUPDTC: DcmDsdSubServiceId=10
                RFCDTC: DcmDsdSubServiceId=12
                RMRTFDTC: DcmDsdSubServiceId=13
                RDTCFDC: DcmDsdSubServiceId=20
            ReadDataById: DcmDsdSidTabServiceId=34, DcmDsdSidTabSubfuncAvail=false
            SecurityAccess: DcmDsdSidTabServiceId=39, DcmDsdSidTabSubfuncAvail=true, DcmDsdSidTabSessionLevelRef=DcmDspSession/Programming, DcmDsdSidTabSessionLevelRef=DcmDspSession/Extended
              4 x DcmDsdSubService, all with DcmDsdSubServiceSessionLevelRef=DcmDspSession/Programming, DcmDsdSubServiceSessionLevelRef=DcmDspSession/Extended:
                SeedLevel1_Request: DcmDsdSubServiceId=1
                KeyLevel1_Send: DcmDsdSubServiceId=2
                requestSeed_Request: DcmDsdSubServiceId=3
                sendKey_Send: DcmDsdSubServiceId=4
            CommunicationControl: DcmDsdSidTabServiceId=40, DcmDsdSidTabSubfuncAvail=true, DcmDsdSidTabSessionLevelRef=DcmDspSession/Programming, DcmDsdSidTabSessionLevelRef=DcmDspSession/Extended
              4 x DcmDsdSubService, all with DcmDsdSubServiceSessionLevelRef=DcmDspSession/Programming, DcmDsdSubServiceSessionLevelRef=DcmDspSession/Extended:
                EnableRxAndTx: DcmDsdSubServiceId=0
                EnableRxAndDisableTx: DcmDsdSubServiceId=1
                DisableRxAndEnableTx: DcmDsdSubServiceId=2
                DisableRxAndTx: DcmDsdSubServiceId=3
            WriteDataById: DcmDsdSidTabServiceId=46, DcmDsdSidTabSubfuncAvail=false
            IoControlById: DcmDsdSidTabServiceId=47, DcmDsdSidTabSubfuncAvail=false, DcmDsdSidTabSessionLevelRef=DcmDspSession/Extended
            RoutineControl: DcmDsdSidTabServiceId=49, DcmDsdSidTabSubfuncAvail=true, DcmDsdSidTabSessionLevelRef=DcmDspSession/Programming, DcmDsdSidTabSessionLevelRef=DcmDspSession/Extended
            RequestDownload: DcmDsdSidTabServiceId=52, DcmDsdSidTabSubfuncAvail=false, DcmDsdSidTabSessionLevelRef=DcmDspSession/Programming, DcmDsdSidTabSessionLevelRef=DcmDspSession/Extended
            TransferData: DcmDsdSidTabServiceId=54, DcmDsdSidTabSubfuncAvail=false, DcmDsdSidTabSessionLevelRef=DcmDspSession/Programming, DcmDsdSidTabSessionLevelRef=DcmDspSession/Extended
            RequestTransferExit: DcmDsdSidTabServiceId=55, DcmDsdSidTabSubfuncAvail=false, DcmDsdSidTabSessionLevelRef=DcmDspSession/Programming, DcmDsdSidTabSessionLevelRef=DcmDspSession/Extended
            TesterPresent: DcmDsdSidTabServiceId=62, DcmDsdSidTabSubfuncAvail=true
              TesterPresent (DcmDsdSubService): DcmDsdSubServiceId=0
            ControlDtcSetting: DcmDsdSidTabServiceId=133, DcmDsdSidTabSubfuncAvail=true
              Enable (DcmDsdSubService): DcmDsdSubServiceId=1
              Disable (DcmDsdSubService): DcmDsdSubServiceId=2
      DcmDsp: DcmDspMaxDidToRead=5
        Example_ReadOnlyDID_DID_Data_GlobalTime (DcmDspData): DcmDspDataSize=48, DcmDspDataType=UINT8_N, DcmDspDataInfoRef=DataInfo_Example_ReadOnlyDID_DID_Data_GlobalTime
        DataInfo_Example_ReadOnlyDID_DID_Data_GlobalTime (DcmDspDataInfo): DcmDspDataFixedLength=true
        Example_ReadWriteData_GlobalTime (DcmDspData): DcmDspDataSize=32, DcmDspDataType=UINT32, DcmDspDataInfoRef=DataInfo_Example_ReadWriteData_GlobalTime
        DataInfo_Example_ReadWriteData_GlobalTime (DcmDspDataInfo): DcmDspDataFixedLength=true
        SampleIoControl_DID_Data (DcmDspData): DcmDspDataConditionCheckReadFncUsed=false, DcmDspDataSize=32, DcmDspDataType=UINT32, DcmDspDataInfoRef=DataInfo_SampleIoControl_DID_Data
        DataInfo_SampleIoControl_DID_Data (DcmDspDataInfo): DcmDspDataFixedLength=true
        Example_WriteOnlyDID_DID_DataObject (DcmDspData): DcmDspDataSize=8, DcmDspDataType=UINT8, DcmDspDataInfoRef=DataInfo_Example_WriteOnlyDID_DID_DataObject
        DataInfo_Example_WriteOnlyDID_DID_DataObject (DcmDspDataInfo): DcmDspDataFixedLength=true
        DID_0x0017_DID_Sint32_Array (DcmDspData): DcmDspDataSize=160, DcmDspDataType=SINT32_N, DcmDspDataInfoRef=DataInfo_DID_0x0017_DID_Sint32_Array
        DataInfo_DID_0x0017_DID_Sint32_Array (DcmDspDataInfo): DcmDspDataFixedLength=true
        DID_0x0018_DID_Uint32_Array (DcmDspData): DcmDspDataSize=192, DcmDspDataType=UINT32_N, DcmDspDataInfoRef=DataInfo_DID_0x0018_DID_Uint32_Array
        DataInfo_DID_0x0018_DID_Uint32_Array (DcmDspDataInfo): DcmDspDataFixedLength=true
        DID_0x0019_DID_Sint16_Array (DcmDspData): DcmDspDataSize=176, DcmDspDataType=SINT16_N, DcmDspDataInfoRef=DataInfo_DID_0x0019_DID_Sint16_Array
        DataInfo_DID_0x0019_DID_Sint16_Array (DcmDspDataInfo): DcmDspDataFixedLength=true
        DID_0x001A_DID_Uint16_Array (DcmDspData): DcmDspDataSize=64, DcmDspDataType=UINT16_N, DcmDspDataInfoRef=DataInfo_DID_0x001A_DID_Uint16_Array
        DataInfo_DID_0x001A_DID_Uint16_Array (DcmDspDataInfo): DcmDspDataFixedLength=true
        DID_0x001B_DID_Sint8_Array (DcmDspData): DcmDspDataSize=224, DcmDspDataType=SINT8_N, DcmDspDataInfoRef=DataInfo_DID_0x001B_DID_Sint8_Array
        DataInfo_DID_0x001B_DID_Sint8_Array (DcmDspDataInfo): DcmDspDataFixedLength=true
        DevelopmentData_OperatingSystemVersion (DcmDspData): DcmDspDataSize=16, DcmDspDataType=UINT16, DcmDspDataInfoRef=DataInfo_DevelopmentData_OperatingSystemVersion
        DataInfo_DevelopmentData_OperatingSystemVersion (DcmDspDataInfo): DcmDspDataFixedLength=true
        DevelopmentData_CanDriverVersion (DcmDspData): DcmDspDataSize=16, DcmDspDataType=UINT16, DcmDspDataInfoRef=DataInfo_DevelopmentData_CanDriverVersion
        DataInfo_DevelopmentData_CanDriverVersion (DcmDspDataInfo): DcmDspDataFixedLength=true
        DevelopmentData_NmVersion (DcmDspData): DcmDspDataSize=16, DcmDspDataType=UINT16, DcmDspDataInfoRef=DataInfo_DevelopmentData_NmVersion
        DataInfo_DevelopmentData_NmVersion (DcmDspDataInfo): DcmDspDataFixedLength=true
        DevelopmentData_DiagnosticModuleVersion (DcmDspData): DcmDspDataSize=16, DcmDspDataType=UINT16, DcmDspDataInfoRef=DataInfo_DevelopmentData_DiagnosticModuleVersion
        DataInfo_DevelopmentData_DiagnosticModuleVersion (DcmDspDataInfo): DcmDspDataFixedLength=true
        DevelopmentData_TransportLayerVersion (DcmDspData): DcmDspDataSize=16, DcmDspDataType=UINT16, DcmDspDataInfoRef=DataInfo_DevelopmentData_TransportLayerVersion
        DataInfo_DevelopmentData_TransportLayerVersion (DcmDspDataInfo): DcmDspDataFixedLength=true
        DataDiagnosticIdentifier_DID_DataDiagnosticIdentifier (DcmDspData): DcmDspDataSize=16, DcmDspDataType=UINT16, DcmDspDataInfoRef=DataInfo_DataDiagnosticIdentifier_DID_DataDiagnosticIdentifier
        DataInfo_DataDiagnosticIdentifier_DID_DataDiagnosticIdentifier (DcmDspDataInfo): DcmDspDataFixedLength=true
        Boot_Software_NumberOfModules (DcmDspData): DcmDspDataSize=8, DcmDspDataType=UINT8, DcmDspDataInfoRef=DataInfo_Boot_Software_NumberOfModules
        DataInfo_Boot_Software_NumberOfModules (DcmDspDataInfo): DcmDspDataFixedLength=true
        Boot_Software_Boot_Software_Identification (DcmDspData): DcmDspDataSize=32, DcmDspDataType=UINT32, DcmDspDataInfoRef=DataInfo_Boot_Software_Boot_Software_Identification
        DataInfo_Boot_Software_Boot_Software_Identification (DcmDspDataInfo): DcmDspDataFixedLength=true
        Spare_Part_Number_Spare_Part_Number (DcmDspData): DcmDspDataSize=104, DcmDspDataType=UINT8_N, DcmDspDataInfoRef=DataInfo_Spare_Part_Number_Spare_Part_Number
        DataInfo_Spare_Part_Number_Spare_Part_Number (DcmDspDataInfo): DcmDspDataFixedLength=true
        EcuIdentification_Part_Number (DcmDspData): DcmDspDataSize=104, DcmDspDataType=UINT8_N, DcmDspDataInfoRef=DataInfo_EcuIdentification_Part_Number
        DataInfo_EcuIdentification_Part_Number (DcmDspDataInfo): DcmDspDataFixedLength=true
        SerialNumber_SerialNumber (DcmDspData): DcmDspDataSize=32, DcmDspDataType=UINT32, DcmDspDataInfoRef=DataInfo_SerialNumber_SerialNumber
        DataInfo_SerialNumber_SerialNumber (DcmDspDataInfo): DcmDspDataFixedLength=true
        Vehicle_Identification_VIN (DcmDspData): DcmDspDataSize=136, DcmDspDataType=UINT8_N, DcmDspDataInfoRef=DataInfo_Vehicle_Identification_VIN
        DataInfo_Vehicle_Identification_VIN (DcmDspDataInfo): DcmDspDataFixedLength=true
        Hardware_Version_Hardware_Version_Number (DcmDspData): DcmDspDataSize=120, DcmDspDataType=UINT8_N, DcmDspDataInfoRef=DataInfo_Hardware_Version_Hardware_Version_Number
        DataInfo_Hardware_Version_Hardware_Version_Number (DcmDspDataInfo): DcmDspDataFixedLength=true
        DID_0xF410_DID_Data (DcmDspData): DcmDspDataSize=16, DcmDspDataType=UINT16, DcmDspDataInfoRef=DataInfo_DID_0xF410_DID_Data
        DataInfo_DID_0xF410_DID_Data (DcmDspDataInfo): DcmDspDataFixedLength=true
        DID_0xF412_DID_Data (DcmDspData): DcmDspDataSize=16, DcmDspDataType=UINT16, DcmDspDataInfoRef=DataInfo_DID_0xF412_DID_Data
        DataInfo_DID_0xF412_DID_Data (DcmDspDataInfo): DcmDspDataFixedLength=true
        DID_0xF413_DID_Data (DcmDspData): DcmDspDataSize=16, DcmDspDataType=UINT16, DcmDspDataInfoRef=DataInfo_DID_0xF413_DID_Data
        DataInfo_DID_0xF413_DID_Data (DcmDspDataInfo): DcmDspDataFixedLength=true
        20 x DcmDspDid:
          Example_ReadOnlyDID: DcmDspDidIdentifier=1, DcmDspDidInfoRef=DidInfo_Example_ReadOnlyDID
            DID_Data_GlobalTime (DcmDspDidSignal): DcmDspDidDataPos=0, DcmDspDidDataRef=Example_ReadOnlyDID_DID_Data_GlobalTime
          Example_ReadWriteData: DcmDspDidIdentifier=2, DcmDspDidInfoRef=DidInfo_Example_ReadWriteData
            GlobalTime (DcmDspDidSignal): DcmDspDidDataPos=0, DcmDspDidDataRef=Example_ReadWriteData_GlobalTime
          SampleIoControl: DcmDspDidIdentifier=3, DcmDspDidInfoRef=DidInfo_SampleIoControl
            DID_Data (DcmDspDidSignal): DcmDspDidDataPos=0, DcmDspDidDataRef=SampleIoControl_DID_Data
          Example_WriteOnlyDID: DcmDspDidIdentifier=4, DcmDspDidInfoRef=DidInfo_Example_WriteOnlyDID
            DID_DataObject (DcmDspDidSignal): DcmDspDidDataPos=0, DcmDspDidDataRef=Example_WriteOnlyDID_DID_DataObject
          DID_0x0017: DcmDspDidIdentifier=23, DcmDspDidInfoRef=DidInfo_DID_0x0017
            DID_Sint32_Array (DcmDspDidSignal): DcmDspDidDataPos=0, DcmDspDidDataRef=DID_0x0017_DID_Sint32_Array
          DID_0x0018: DcmDspDidIdentifier=24, DcmDspDidInfoRef=DidInfo_DID_0x0018
            DID_Uint32_Array (DcmDspDidSignal): DcmDspDidDataPos=0, DcmDspDidDataRef=DID_0x0018_DID_Uint32_Array
          DID_0x0019: DcmDspDidIdentifier=25, DcmDspDidInfoRef=DidInfo_DID_0x0019
            DID_Sint16_Array (DcmDspDidSignal): DcmDspDidDataPos=0, DcmDspDidDataRef=DID_0x0019_DID_Sint16_Array
          DID_0x001A: DcmDspDidIdentifier=26, DcmDspDidInfoRef=DidInfo_DID_0x001A
            DID_Uint16_Array (DcmDspDidSignal): DcmDspDidDataPos=0, DcmDspDidDataRef=DID_0x001A_DID_Uint16_Array
          DID_0x001B: DcmDspDidIdentifier=27, DcmDspDidInfoRef=DidInfo_DID_0x001B
            DID_Sint8_Array (DcmDspDidSignal): DcmDspDidDataPos=0, DcmDspDidDataRef=DID_0x001B_DID_Sint8_Array
          DevelopmentData: DcmDspDidIdentifier=256, DcmDspDidInfoRef=DidInfo_DevelopmentData
            5 x DcmDspDidSignal:
              OperatingSystemVersion: DcmDspDidDataPos=0, DcmDspDidDataRef=DevelopmentData_OperatingSystemVersion
              CanDriverVersion: DcmDspDidDataPos=16, DcmDspDidDataRef=DevelopmentData_CanDriverVersion
              NmVersion: DcmDspDidDataPos=32, DcmDspDidDataRef=DevelopmentData_NmVersion
              DiagnosticModuleVersion: DcmDspDidDataPos=48, DcmDspDidDataRef=DevelopmentData_DiagnosticModuleVersion
              TransportLayerVersion: DcmDspDidDataPos=64, DcmDspDidDataRef=DevelopmentData_TransportLayerVersion
          DataDiagnosticIdentifier_DID: DcmDspDidIdentifier=257, DcmDspDidInfoRef=DidInfo_DataDiagnosticIdentifier_DID
            DataDiagnosticIdentifier (DcmDspDidSignal): DcmDspDidDataPos=0, DcmDspDidDataRef=DataDiagnosticIdentifier_DID_DataDiagnosticIdentifier
          Boot_Software: DcmDspDidIdentifier=61824, DcmDspDidInfoRef=DidInfo_Boot_Software
            NumberOfModules (DcmDspDidSignal): DcmDspDidDataPos=0, DcmDspDidDataRef=Boot_Software_NumberOfModules
            Boot_Software_Identification (DcmDspDidSignal): DcmDspDidDataPos=8, DcmDspDidDataRef=Boot_Software_Boot_Software_Identification
          Spare_Part_Number: DcmDspDidIdentifier=61831, DcmDspDidInfoRef=DidInfo_Spare_Part_Number
            Spare_Part_Number (DcmDspDidSignal): DcmDspDidDataPos=0, DcmDspDidDataRef=Spare_Part_Number_Spare_Part_Number
          EcuIdentification: DcmDspDidIdentifier=61833, DcmDspDidInfoRef=DidInfo_EcuIdentification
            Part_Number (DcmDspDidSignal): DcmDspDidDataPos=0, DcmDspDidDataRef=EcuIdentification_Part_Number
          SerialNumber: DcmDspDidIdentifier=61836, DcmDspDidInfoRef=DidInfo_SerialNumber
            SerialNumber (DcmDspDidSignal): DcmDspDidDataPos=0, DcmDspDidDataRef=SerialNumber_SerialNumber
          Vehicle_Identification: DcmDspDidIdentifier=61840, DcmDspDidInfoRef=DidInfo_Vehicle_Identification
            VIN (DcmDspDidSignal): DcmDspDidDataPos=0, DcmDspDidDataRef=Vehicle_Identification_VIN
          Hardware_Version: DcmDspDidIdentifier=61843, DcmDspDidInfoRef=DidInfo_Hardware_Version
            Hardware_Version_Number (DcmDspDidSignal): DcmDspDidDataPos=0, DcmDspDidDataRef=Hardware_Version_Hardware_Version_Number
          DID_0xF410: DcmDspDidIdentifier=62480, DcmDspDidInfoRef=DidInfo_DID_0xF410
            DID_Data (DcmDspDidSignal): DcmDspDidDataPos=0, DcmDspDidDataRef=DID_0xF410_DID_Data
          DID_0xF412: DcmDspDidIdentifier=62482, DcmDspDidInfoRef=DidInfo_DID_0xF412
            DID_Data (DcmDspDidSignal): DcmDspDidDataPos=0, DcmDspDidDataRef=DID_0xF412_DID_Data
          DID_0xF413: DcmDspDidIdentifier=62483, DcmDspDidInfoRef=DidInfo_DID_0xF413
            DID_Data (DcmDspDidSignal): DcmDspDidDataPos=0, DcmDspDidDataRef=DID_0xF413_DID_Data
        20 x DcmDspDidInfo:
          DidInfo_Example_ReadOnlyDID
            DcmDspDidAccess
              DcmDspDidRead
          DidInfo_Example_ReadWriteData
            DcmDspDidAccess
              DcmDspDidRead
              DcmDspDidWrite
          DidInfo_SampleIoControl
            DcmDspDidAccess
              DcmDspDidControl:
                DcmDspDidFreezeCurrentState = true
                DcmDspDidResetToDefault = true
                DcmDspDidReturnControlToEcu = true
                DcmDspDidShortTermAdjustment = true
                DcmDspDidControlSessionRef = DcmDspSession/Extended
              DcmDspDidRead
          DidInfo_Example_WriteOnlyDID
            DcmDspDidAccess
              DcmDspDidWrite
          DidInfo_DID_0x0017
            DcmDspDidAccess
              DcmDspDidWrite
          DidInfo_DID_0x0018
            DcmDspDidAccess
              DcmDspDidRead
              DcmDspDidWrite
          DidInfo_DID_0x0019
            DcmDspDidAccess
              DcmDspDidRead
          DidInfo_DID_0x001A
            DcmDspDidAccess
              DcmDspDidRead
              DcmDspDidWrite
          DidInfo_DID_0x001B
            DcmDspDidAccess
              DcmDspDidWrite
          DidInfo_DevelopmentData
            DcmDspDidAccess
              DcmDspDidRead
              DcmDspDidWrite
          DidInfo_DataDiagnosticIdentifier_DID
            DcmDspDidAccess
              DcmDspDidRead
              DcmDspDidWrite
          DidInfo_Boot_Software
            DcmDspDidAccess
              DcmDspDidRead
              DcmDspDidWrite
          DidInfo_Spare_Part_Number
            DcmDspDidAccess
              DcmDspDidRead
              DcmDspDidWrite
          DidInfo_EcuIdentification
            DcmDspDidAccess
              DcmDspDidRead
              DcmDspDidWrite
          DidInfo_SerialNumber
            DcmDspDidAccess
              DcmDspDidRead
              DcmDspDidWrite
          DidInfo_Vehicle_Identification
            DcmDspDidAccess
              DcmDspDidRead
              DcmDspDidWrite
          DidInfo_Hardware_Version
            DcmDspDidAccess
              DcmDspDidRead
              DcmDspDidWrite
          DidInfo_DID_0xF410
            DcmDspDidAccess
              DcmDspDidRead
          DidInfo_DID_0xF412
            DcmDspDidAccess
              DcmDspDidRead
          DidInfo_DID_0xF413
            DcmDspDidAccess
              DcmDspDidRead
        SampleRoutineControl (DcmDspRoutine):
          DcmDspRequestResultsRoutineSupported = true
          DcmDspStopRoutineSupported = true
          DcmDspRoutineIdentifier = 256
          DcmDspRoutineInfoRef = RoutineInfo_SampleRoutineControl
        SampleRoutineControl_StartOnly (DcmDspRoutine):
          DcmDspRequestResultsRoutineSupported = true
          DcmDspStopRoutineSupported = false
          DcmDspRoutineIdentifier = 260
          DcmDspRoutineInfoRef = RoutineInfo_SampleRoutineControl_StartOnly
        RoutineInfo_SampleRoutineControl (DcmDspRoutineInfo)
          DcmDspRoutineAuthorization: DcmDspRoutineSessionRef=DcmDspSession/Programming, DcmDspRoutineSessionRef=DcmDspSession/Extended
          DcmDspStartRoutineIn
            In_Option0 (DcmDspStartRoutineInSignal): DcmDspRoutineSignalLength=8, DcmDspRoutineSignalType=UINT8, DcmDspRoutineSignalPos=0
          DcmDspStartRoutineOut
            Out_InitState (DcmDspStartRoutineOutSignal): DcmDspRoutineSignalLength=32, DcmDspRoutineSignalType=UINT32, DcmDspRoutineSignalEndianness=BIG_ENDIAN, DcmDspRoutineSignalPos=0
          DcmDspRoutineStopOut
            Out_StopState (DcmDspRoutineStopOutSignal): DcmDspRoutineSignalLength=32, DcmDspRoutineSignalType=UINT32, DcmDspRoutineSignalEndianness=BIG_ENDIAN, DcmDspRoutineSignalPos=0
          DcmDspRoutineRequestResOut
            Out_Result (DcmDspRoutineRequestResOutSignal): DcmDspRoutineSignalLength=16, DcmDspRoutineSignalType=UINT16, DcmDspRoutineSignalEndianness=BIG_ENDIAN, DcmDspRoutineSignalPos=0
        RoutineInfo_SampleRoutineControl_StartOnly (DcmDspRoutineInfo)
          DcmDspRoutineAuthorization: DcmDspRoutineSessionRef=DcmDspSession/Programming, DcmDspRoutineSessionRef=DcmDspSession/Extended
          DcmDspStartRoutineIn
            In_Option1 (DcmDspStartRoutineInSignal): DcmDspRoutineSignalLength=24, DcmDspRoutineSignalType=UINT8_N, DcmDspRoutineSignalEndianness=opaque, DcmDspRoutineSignalPos=0
          DcmDspRoutineRequestResOut
            Out_Result (DcmDspRoutineRequestResOutSignal): DcmDspRoutineSignalLength=32, DcmDspRoutineSignalType=UINT32, DcmDspRoutineSignalEndianness=BIG_ENDIAN, DcmDspRoutineSignalPos=0
        DcmDspSecurity
          UnlockedL1 (DcmDspSecurityRow):
            DcmDspSecurityDelayTime = 10
            DcmDspSecurityDelayTimeOnBoot = 0
            DcmDspSecurityKeySize = 4
            DcmDspSecurityLevel = 1
            DcmDspSecurityNumAttDelay = 3
            DcmDspSecuritySeedSize = 4
          Level_3 (DcmDspSecurityRow):
            DcmDspSecurityDelayTime = 10
            DcmDspSecurityDelayTimeOnBoot = 0
            DcmDspSecurityKeySize = 2
            DcmDspSecurityLevel = 2
            DcmDspSecurityNumAttDelay = 3
            DcmDspSecuritySeedSize = 2
        DcmDspSession
          3 x DcmDspSessionRow, all with DcmDspSessionP2ServerMax=0.05, DcmDspSessionP2StarServerMax=5:
            Default: DcmDspSessionLevel=1, DcmDspSessionForBoot=DCM_NO_BOOT
            Programming: DcmDspSessionLevel=2
            Extended: DcmDspSessionLevel=3, DcmDspSessionForBoot=DCM_NO_BOOT
        ComControl (DcmDspComControl)
          DspComContolAllChannel (DcmDspComControlAllChannel)
  module config Dem: module-description=Dem_Impl
    DemConfigSet
      DtcAttributes_41914fb7 (DemDTCAttributes): DemMemoryDestinationRef=PrimaryMemory
      DTCClass_DTC_0x000002 (DemDTCClass): DemDTCSeverity=DEM_DTC_SEV_NO_SEVERITY, DemUdsDTC=2, DemDTCAttributesRef=DtcAttributes_41914fb7
      DTC_0x000002 (DemEventParameter):
        DemEventKind = DEM_EVENT_KIND_SWC
        DemMaxNumberFreezeFrameRecords = 1
        DemDTCClassRef = DTCClass_DTC_0x000002
        DemExtendedDataClassRef = ExtendedDataClass_83dcefb7
        DemFreezeFrameClassRef = FreezeFrameClass_7d61125a
        DemDebounceAlgorithmClass
          DemDebounceCounterBased: DemDebounceCounterBasedClassRef=DTC_0x000002_DebounceAlgorithmProperties
        DemCallbackInitMForE
        DemEventClass:
          DemAgingAllowed = false
          DemAgingCycleCounterThreshold = 100
          DemEventPriority = 2
          DemEventSignificance = DEM_EVENT_SIGNIFICANCE_FAULT
          DemEventFailureCycleCounterThreshold = 0
          DemAgingCycleRef = IgnitionCycle
          DemOperationCycleRef = PowerCycle
          IndicatorAttribute_WarningIndicator (DemIndicatorAttribute): DemIndicatorFailureCycleSource=DEM_FAILURE_CYCLE_EVENT, DemIndicatorHealingCycleRef=PowerCycle, DemIndicatorRef=WarningIndicator
      DTCClass_DTC_0x000003 (DemDTCClass): DemDTCSeverity=DEM_DTC_SEV_NO_SEVERITY, DemUdsDTC=3, DemDTCAttributesRef=DtcAttributes_41914fb7
      DTC_0x000003 (DemEventParameter):
        DemEventKind = DEM_EVENT_KIND_SWC
        DemMaxNumberFreezeFrameRecords = 1
        DemDTCClassRef = DTCClass_DTC_0x000003
        DemExtendedDataClassRef = ExtendedDataClass_83dcefb7
        DemFreezeFrameClassRef = FreezeFrameClass_89a2d1a5
        DemDebounceAlgorithmClass
          DemDebounceCounterBased: DemDebounceCounterBasedClassRef=DTC_0x000002_DebounceAlgorithmProperties
        DemEventClass:
          DemAgingAllowed = true
          DemAgingCycleCounterThreshold = 40
          DemEventPriority = 1
          DemEventSignificance = DEM_EVENT_SIGNIFICANCE_FAULT
          DemEventFailureCycleCounterThreshold = 2
          DemAgingCycleRef = WarmUpCycle
          DemOperationCycleRef = OBDDrivingCycle
          IndicatorAttribute_WarningIndicator (DemIndicatorAttribute): DemIndicatorFailureCycleSource=DEM_FAILURE_CYCLE_EVENT, DemIndicatorHealingCycleRef=OBDDrivingCycle, DemIndicatorRef=WarningIndicator
      DTC_0x000002_DebounceAlgorithmProperties (DemDebounceCounterBasedClass): DemDebounceCounterDecrementStepSize=1, DemDebounceCounterIncrementStepSize=1, DemDebounceCounterJumpDown=false, DemDebounceCounterJumpUp=true
    DemGeneral:
      DemOBDSupport = DEM_OBD_NO_OBD_SUPPORT
      DemAgingCycleCounterProcessing = DEM_PROCESS_AGINGCTR_INTERN
      DemDebounceCounterBasedSupport = true
      DemPTOSupport = false
      DemDtcStatusAvailabilityMask = 255
      DemEventMemorySet
        PrimaryMemory (DemPrimaryMemory): DemTypeOfFreezeFrameRecordNumeration=DEM_FF_RECNUM_CALCULATED
      3 x DemDidClass:
        Example_ReadOnlyDID: DemDidIdentifier=1, DemDidDataClassRef=DID_0x1_DID_Data_GlobalTime
        DID_0xF412: DemDidIdentifier=62482, DemDidDataClassRef=PID_0x12_DID_Data
        DID_0xF413: DemDidIdentifier=62483, DemDidDataClassRef=PID_0x13_DID_Data
      ExtendedDataClass_83dcefb7 (DemExtendedDataClass): DemExtendedDataRecordClassRef=OccurrenceCounter
      OccurrenceCounter (DemExtendedDataRecordClass):
        DemExtendedDataRecordNumber = 1
        DemExtendedDataRecordTrigger = DEM_TRIGGER_ON_TEST_FAILED
        DemExtendedDataRecordUpdate = DEM_UPDATE_RECORD_NO
        DemDataClassRef = OccurrenceCounter_Occurrence_Counter
      FreezeFrameClass_7d61125a (DemFreezeFrameClass): DemDidClassRef=DemGeneral/Example_ReadOnlyDID
      FreezeFrameClass_89a2d1a5 (DemFreezeFrameClass): DemDidClassRef=DemGeneral/Example_ReadOnlyDID, DemDidClassRef=DemGeneral/DID_0xF412, DemDidClassRef=DemGeneral/DID_0xF413
      WarningIndicator (DemIndicator)
      4 x DemOperationCycle:
        IgnitionCycle: DemOperationCycleType=DEM_OPCYC_IGNITION
        OBDDrivingCycle: DemOperationCycleType=DEM_OPCYC_OBD_DCY
        PowerCycle: DemOperationCycleType=DEM_OPCYC_POWER
        WarmUpCycle: DemOperationCycleType=DEM_OPCYC_WARMUP
      4 x DemDataClass:
        PID_0x12_DID_Data: DemDataElementDataSize=2, DemDataElementDataType=UINT16, DemDataElementEndianness=BIG_ENDIAN, DemDataElementUsePort=USE_DATA_CLIENT_SERVER_PORT, DemDataElementStoreNonVolatile=true
        PID_0x13_DID_Data: DemDataElementDataSize=2, DemDataElementDataType=UINT16, DemDataElementEndianness=BIG_ENDIAN, DemDataElementUsePort=USE_DATA_CLIENT_SERVER_PORT, DemDataElementStoreNonVolatile=true
        DID_0x1_DID_Data_GlobalTime: DemDataElementDataSize=6, DemDataElementDataType=UINT8_N, DemDataElementEndianness=opaque, DemDataElementUsePort=USE_DATA_CLIENT_SERVER_PORT, DemDataElementStoreNonVolatile=true
        OccurrenceCounter_Occurrence_Counter: DemDataElementDataSize=1, DemDataElementInternalData=DEM_OCCCTR, DemDataElementUsePort=USE_DATA_INTERNAL
