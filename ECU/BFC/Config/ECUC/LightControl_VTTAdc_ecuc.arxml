AUTOSAR XML (schema 00049)
package /ActiveEcuC
  module config VTTAdc: implementation-config-variant=VARIANT-PRE-COMPILE, module-description=VTTAdc_Impl
    AdcGeneral:
      AdcDevErrorDetect = true
      AdcEnableLimitCheck = false
      AdcEnableQueuing = false
      AdcEnableStartStopGroupApi = true
      AdcPriorityImplementation = ADC_PRIORITY_NONE
      AdcReadGroupApi = true
      AdcResultAlignment = ADC_ALIGN_RIGHT
      AdcVersionInfoApi = false
      AdcSafeBswChecks = false
      AdcHwTriggerApi = false
      AdcGrpNotifCapability = true
      AdcDeInitApi = false
    AdcPublishedInformation: AdcChannelValueSigned=false, AdcGroupFirstChannelFixed=false, AdcMaxChannelResolution=32
    AdcConfigSet
      AdcHwUnit_0 (AdcHwUnit): AdcHwUnitId=Hw0, AdcPrescale=4
        AdcGroupLight (AdcGroup):
          AdcGroupAccessMode = ADC_ACCESS_MODE_SINGLE
          AdcGroupConversionMode = ADC_CONV_MODE_CONTINUOUS
          AdcGroupTriggSrc = ADC_TRIGG_SRC_SW
          AdcStreamingBufferMode = ADC_STREAM_BUFFER_LINEAR
          AdcStreamingNumSamples = 1
          AdcGroupId = 0
          AdcGroupDefinition = AdcLightIntensity
        AdcLightIntensity (AdcChannel):
          AdcChannelConvTime = 1000
          AdcChannelRefVoltsrcHigh = ADC_5V
          AdcChannelRefVoltsrcLow = ADC_0V
          AdcChannelResolution = 10
          AdcChannelSampTime = 254
          AdcChannelId = 0
