AUTOSAR XML (schema 00049)
package /ActiveEcuC
  module config VTTCan: implementation-config-variant=VARIANT-PRE-COMPILE, module-description=VTTCan_Impl
    CanConfigSet
      CN_CAN00_e8c1d35b_Rx_Std (CanHardwareObject):
        CanHandleType = BASIC
        CanIdType = STANDARD
        CanIdValue = 0
        CanObjectId = 1
        CanObjectType = RECEIVE
        CanHwProcessing = false
        CanObjectHwSize = 2
        CanObjectHwHandle = 1
        CanMaxDataLen = 8
        CanFdPaddingValue = 0
        CanObjectMultiplexedTransmission = false
        CanObjectHwFifo = false
        CanControllerRef = CT_CAN00_6199f384
        CanFilterMaskRef = CanFilterMask
      CT_CAN00_6199f384 (CanController):
        CanBusoffProcessing = INTERRUPT
        CanControllerActivation = true
        CanControllerBaseAddress = 0
        CanControllerId = 0
        CanRxProcessing = INTERRUPT
        CanTxProcessing = INTERRUPT
        CanWakeupProcessing = INTERRUPT
        CanWakeupSupport = false
        CanWakeupSourceId = 0
        CanBusName = CAN00
        CanCommonCAN = false
        CanControllerDefaultBaudrate = CanControllerBaudrateConfig
        CanWakeupSourceRef = CAN00_f26020e5
        CanControllerBaudrateConfig:
          CanControllerBaudRate = 500
          CanControllerBaudRateConfigID = 0
          CanControllerPropSeg = 3
          CanControllerSeg1 = 2
          CanControllerSeg2 = 2
          CanControllerSyncJumpWidth = 1
          CanBaudrateClock = 8000
          CanBaudratePrescaler = 2
          CanSamplingMode = OneSample
        CanFilterMask: CanFilterMaskValue=0, CanFilterCodeValue=0, IsLocked=false
        CanFilterMask_001 (CanFilterMask): CanFilterMaskValue=0, CanFilterCodeValue=0, IsLocked=false
      CN_CAN00_a2373004_Tx (CanHardwareObject):
        CanHandleType = BASIC
        CanIdType = STANDARD
        CanIdValue = 0
        CanObjectId = 0
        CanObjectType = TRANSMIT
        CanHwProcessing = false
        CanObjectHwSize = 1
        CanObjectHwHandle = 0
        CanMaxDataLen = 8
        CanFdPaddingValue = 0
        CanObjectMultiplexedTransmission = false
        CanObjectHwFifo = false
        CanControllerRef = CT_CAN00_6199f384
      CN_CAN00_193527e3_Rx (CanHardwareObject):
        CanHandleType = BASIC
        CanIdType = STANDARD
        CanIdValue = 0
        CanObjectId = 2
        CanObjectType = RECEIVE
        CanHwProcessing = false
        CanObjectHwSize = 5
        CanObjectHwHandle = 3
        CanMaxDataLen = 8
        CanObjectMultiplexedTransmission = false
        CanObjectHwFifo = false
        CanFdPaddingValue = 0
        CanControllerRef = CT_CAN00_6199f384
        CanFilterMaskRef = CanFilterMask_001
    CanGeneral:
      CanChangeBaudrateApi = false
      CanDevErrorDetection = true
      CanHardwareCancellation = false
      CanIdenticalIdCancellation = false
      CanMainFunctionBusoffPeriod = 0.01
      CanMainFunctionModePeriod = 0.01
      CanMainFunctionWakeupPeriod = 0.01
      CanMultiplexedTransmission = false
      CanSetBaudrateApi = true
      CanTimeoutDuration = 0.01
      CanVersionInfoApi = true
      CanGenericPrecopy = false
      CanHardwareLoopCheck = false
      CanRxFullCANSupport = false
      CanTxFullCANSupport = false
      CanRxBasicCANSupport = true
      CanUseNestedCANInterrupts = false
      CanHardwareCancelByAppl = false
      CanIndividualProcessing = false
      CanGenericConfirmation = false
      CanRxQueue = false
      CanSupportMixedID = false
      CanRxQueueSize = 10
      CanMultipleBasicCANObjects = false
      CanHardwareHandleType = UINT8
      CanOptimizeOneController = true
      CanInterruptCategory = CATEGORY2
      CanGetStatus = true
      CanInterruptLock = DRIVER
      CanWakeupSupport = true
      CanRamCheck = None
      CanOverrunNotification = None
      CanReinitStart = false
      CanGenericPreTransmit = false
      CanFdSupport = NONE
      CanRuntimeMeasurementSupport = false
      CanMaxRxDataLen = 8
      CanMaxTxDataLen = 8
      CanUsePeripheralAccessApi = false
      CanMirrorModeSupport = false
      CanIndex = 0
      CanUseOsInterruptControl = false
      CanMultipleBasicCANTxObjects = false
      CanSafeBswChecks = false
      CanSilentModeSupport = false
      CanCheckWakeupCanRetType = false
      CanFdHardwareBufferOptimization = true
      CanGenericConfirmationAPI2 = false
      CanHwTxFifoSupport = false
      CanEnableSecurityEventReporting = false
      CanMainFunctionRWPeriods
