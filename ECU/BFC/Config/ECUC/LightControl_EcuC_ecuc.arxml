AUTOSAR XML (schema 00049)
package /ActiveEcuC
  module config EcuC: implementation-config-variant=VARIANT-PRE-COMPILE, module-description=EcuC_Impl
    EcucPduCollection: PduIdTypeEnum=UINT8, PduLengthTypeEnum=UINT16
      15 x Pdu, all with J1939Requestable=false:
        CAN00_NmRxPdu_f26020e5: PduLength=8
        LightSwitch_oCAN00_8d4de26e_Rx: DynamicLength=false, PduLength=2, SysTPduToFrameMappingRef=LightSwitch
        LightCtrl_oCAN00_0afee19e_Tx: DynamicLength=false, PduLength=8, SysTPduToFrameMappingRef=LightCtrl
        LightCtrl_oCAN00_2e88b3f5_Tx: DynamicLength=false, PduLength=8
        LightSwitch_oCAN00_d3b6d56e_Rx: DynamicLength=false, PduLength=2
        Msg_Diag_Response_BFC_oCAN00_61e49ee1_Tx: DynamicLength=true, PduLength=8
        Msg_Diag_Request_BFC_oCAN00_7ad4193d_Rx: DynamicLength=true, PduLength=8
        Msg_Diag_Response_BFC_Tp_oCAN00_2e02c5db_Tx: DynamicLength=false, PduLength=8, SysTPduToFrameMappingRef=Msg_Diag_Response_BFC_Tp
        Msg_Diag_Request_BFC_oCAN00_dced82e4_Rx: DynamicLength=true, PduLength=8
        Msg_Diag_Request_Global_Tp_oCAN00_eed4c6c0_Rx: DynamicLength=false, PduLength=8, SysTPduToFrameMappingRef=Msg_Diag_Request_Global_Tp
        Msg_Diag_Uudt_Response_BFC_oCAN00_e0f86470_Tx: DynamicLength=true, PduLength=8
        Msg_Diag_Request_Global_oCAN00_85e930b7_Rx: DynamicLength=true, PduLength=7
        Msg_Diag_Request_BFC_Tp_oCAN00_ebe478a8_Rx: DynamicLength=false, PduLength=8, SysTPduToFrameMappingRef=Msg_Diag_Request_BFC_Tp
        Msg_Diag_Response_BFC_oCAN00_68c05815_Tx: DynamicLength=true, PduLength=8
        Msg_Diag_Request_Global_oCAN00_4d90f286_Rx: DynamicLength=true, PduLength=7
    EcucGeneral:
      CPUType = CPU32Bit
      SizeOfInt = Size32Bit
      ByteOrder = LITTLE_ENDIAN
      BitOrder = LSB_to_MSB
      AtomicBitAccessInBitfield = false
      AtomicVariableAccess = Atomic32BitAccess
      SizeOfEnum = Size32Bit
      SizeOfROMPointer = Size32Bit
      SizeOfRAMPointer = Size32Bit
      BitFieldDataType = INT
      StructAlignment = Auto
      ArrayAlignment = Auto
      StructInArrayAlignment = Auto
      DummyFunction = false
      DummyStatement = false
      DummyStatementKind = None
      ConditionalGenerating = true
      EcucBswImplementationCodeType = EcuCSourceCode
      EcuCUseStdReturnTypeForRte = false
      BswInitialization
        51 x InitFunction:
          PduR_Init: Header=PduR.h, InitPhase=INIT_TWO_COM, ConfigType=PduR_PBConfigType, ConfigPtrName=PduR_Config_Ptr, ConfigPtrClass=PDUR_INIT_DATA, ModuleRef=PduR  # Ecuc Bsw Init Function PLAIN_TEXT Init function description of PduR in ModelView (UnfilteredInvariantProjectModelView) .
          ComM_Init: Header=ComM.h, InitPhase=INIT_TWO_POST_NVMREADALL, ConfigType=ComM_ConfigType, ConfigPtrName=ComM_Config_Ptr, ConfigPtrClass=COMM_INIT_DATA, ModuleRef=ComM  # Ecuc Bsw Init Function PLAIN_TEXT Init function description of ComM UB:Init function description of ComM /ActiveEcuC/ComM Init function description of ComM in UnfilteredViewInInvariantProject (UnfilteredInvariantProjectModelView) .
          Com_Init: Header=Com.h, InitPhase=INIT_TWO_COM, ConfigType=Com_ConfigType, ConfigPtrName=Com_Config_Ptr, ConfigPtrClass=COM_INIT_DATA, ModuleRef=Com  # Ecuc Bsw Init Function PLAIN_TEXT Init function description of Com in ModelView (UnfilteredInvariantProjectModelView) .
          EcuM_Init: Header=EcuM.h, InitPhase=NO_INIT, ConfigType=EcuM_PbConfigType, ConfigPtrName=EcuM_Config_Ptr, ConfigPtrClass=ECUM_INIT_DATA, ModuleRef=EcuM  # Ecuc Bsw Init Function PLAIN_TEXT Init function description of EcuM in ModelView (UnfilteredInvariantProjectModelView) .
          CanSM_Init: Header=CanSM_EcuM.h, InitPhase=INIT_TWO_SM, ConfigType=CanSM_ConfigType, ConfigPtrName=CanSM_Config_Ptr, ConfigPtrClass=CANSM_INIT_DATA, ModuleRef=CanSM  # Ecuc Bsw Init Function PLAIN_TEXT Init function description of CanSM in ModelView (UnfilteredInvariantProjectModelView) .
          BswM_Init: Header=BswM.h, ConfigType=BswM_ConfigType, ConfigPtrName=BswM_Config_Ptr, ConfigPtrClass=BSWM_INIT_DATA, InitPhase=NO_INIT, ModuleRef=BswM  # Ecuc Bsw Init Function PLAIN_TEXT Init function description of BswM in ModelView (UnfilteredInvariantProjectModelView) .
          CanIf_Init: Header=CanIf.h, InitPhase=INIT_TWO_IF, ConfigType=CanIf_ConfigType, ConfigPtrName=CanIf_Config_Ptr, ConfigPtrClass=CANIF_INIT_DATA, ModuleRef=CanIf  # Ecuc Bsw Init Function PLAIN_TEXT Init function description of CanIf in ModelView (UnfilteredInvariantProjectModelView) .
          BswM_InitMemory: Header=BswM.h, InitPhase=INIT_MEMORY, ModuleRef=BswM  # Ecuc Bsw Init Function PLAIN_TEXT InitMemory function description of BswM in ModelView (UnfilteredInvariantProjectModelView) .
          CanIf_InitMemory: Header=CanIf.h, InitPhase=INIT_MEMORY, ModuleRef=CanIf  # Ecuc Bsw Init Function PLAIN_TEXT InitMemory function description of CanIf in ModelView (UnfilteredInvariantProjectModelView) .
          CanSM_InitMemory: Header=CanSM_EcuM.h, InitPhase=INIT_MEMORY, ModuleRef=CanSM  # Ecuc Bsw Init Function PLAIN_TEXT InitMemory function description of CanSM in ModelView (UnfilteredInvariantProjectModelView) .
          Com_InitMemory: Header=Com.h, InitPhase=INIT_MEMORY, ModuleRef=Com  # Ecuc Bsw Init Function PLAIN_TEXT InitMemory function description of Com in ModelView (UnfilteredInvariantProjectModelView) .
          ComM_InitMemory: Header=ComM.h, InitPhase=INIT_MEMORY, ModuleRef=ComM  # Ecuc Bsw Init Function PLAIN_TEXT Initializes variables of Communication Manager
          Dem_InitMemory: Header=Dem.h, InitPhase=INIT_MEMORY, ModuleRef=Dem  # Ecuc Bsw Init Function PLAIN_TEXT InitMemory function description of Dem in ModelView (UnfilteredInvariantProjectModelView) .
          Dem_PreInit: Header=Dem.h, InitPhase=INIT_ZERO, ConfigType=Dem_ConfigType, ConfigPtrName=Dem_Config_Ptr, ConfigPtrClass=DEM_INIT_DATA, ModuleRef=Dem  # Ecuc Bsw Init Function PLAIN_TEXT PreInit function description of Dem in ModelView (UnfilteredInvariantProjectModelView) .
          Dem_Init: Header=Dem.h, InitPhase=INIT_TWO_POST_NVMREADALL, ConfigType=Dem_ConfigType, ConfigPtrName=Dem_Config_Ptr, ConfigPtrClass=DEM_INIT_DATA, ModuleRef=Dem  # Ecuc Bsw Init Function PLAIN_TEXT Init function description of Dem in ModelView (UnfilteredInvariantProjectModelView) .
          PduR_InitMemory: Header=PduR.h, InitPhase=INIT_MEMORY, ModuleRef=PduR  # Ecuc Bsw Init Function PLAIN_TEXT InitMemory function description of PduR in ModelView (UnfilteredInvariantProjectModelView) .
          Rte_InitMemory: Header=Rte_Main.h, InitPhase=INIT_MEMORY, ModuleRef=Rte  # UB:Automatically generated by EcuCBswInitFctConfigurationService.
          Det_Init: Header=Det.h, InitPhase=INIT_ZERO, ConfigType=Det_ConfigType, ConfigPtrName=Det_Config_Ptr, ConfigPtrClass=DET_INIT_DATA, ModuleRef=Det  # UB:Initialization of the Det and its internal state machine
          Det_Start: Header=Det.h, InitPhase=INIT_ONE, ModuleRef=Det
          SchM_Init: Header=Rte_Main.h, InitPhase=NO_INIT, ModuleRef=Rte  # UB:Automatically generated by EcuCBswInitFctConfigurationService.
          Det_InitMemory: Header=Det.h, InitPhase=INIT_MEMORY, ModuleRef=Det  # UB:Initialize Memory, so that expected start values are set
          BswM_PreInit: Header=BswM.h, InitPhase=INIT_ONE, ConfigType=BswM_ConfigType, ConfigPtrName=BswM_Config_Ptr, ConfigPtrClass=BSWM_INIT_DATA, ModuleRef=BswM
          Rte_StartTiming: Header=Rte_Main.h, InitPhase=NO_INIT, ModuleRef=Rte
          Rte_Start: Header=Rte_Main.h, InitPhase=INIT_THREE, ModuleRef=Rte
          PduR_PreInit: Header=PduR.h, InitPhase=INIT_ONE, ConfigType=PduR_PBConfigType, ConfigPtrName=PduR_Config_Ptr, ConfigPtrClass=PDUR_INIT_DATA, ModuleRef=PduR
          ComM_PostInit: Header=ComM.h, InitPhase=INIT_THREE, ModuleRef=ComM  # /ActiveEcuC/ComM PLAIN_TEXT Post-Initialization of the ComM and its internal state machine
          ComM_PreInit: Header=ComM.h, InitPhase=INIT_ONE, ConfigType=ComM_ConfigType, ConfigPtrName=ComM_Config_Ptr, ConfigPtrClass=COMM_INIT_DATA, ModuleRef=ComM  # /ActiveEcuC/ComM PLAIN_TEXT PreInit function description of ComM in UnfilteredViewInInvariantProject (UnfilteredInvariantProjectModelView) .
          SchM_StartTiming: Header=Rte_Main.h, InitPhase=NO_INIT, ModuleRef=Rte  # /ActiveEcuC/Rte PLAIN_TEXT Automatically generated by EcuCBswInitFctConfigurationService.
          SchM_Start: Header=Rte_Main.h, InitPhase=NO_INIT, ModuleRef=Rte  # /ActiveEcuC/Rte PLAIN_TEXT Automatically generated by EcuCBswInitFctConfigurationService.
          Can_30_Core_Init: Header=Can_30_Core.h, InitPhase=INIT_TWO_DRV, ConfigType=Can_30_Core_ConfigType, ConfigPtrClass=CAN_30_CORE_INIT_DATA, ConfigPtrName=Can_30_Core_Config_Ptr, ModuleRef=Can  # /ActiveEcuC/Can PLAIN_TEXT Init function description of Can_30_Core in UnfilteredViewInInvariantProject (UnfilteredInvariantProjectModelView) .
          Can_30_Core_InitMemory: Header=Can_30_Core.h, InitPhase=INIT_MEMORY, ModuleRef=Can  # /ActiveEcuC/Can PLAIN_TEXT InitMemory function description of Can_30_Core in UnfilteredViewInInvariantProject (UnfilteredInvariantProjectModelView) .
          vCan_30_Mcan_Init: Header=vCan_30_Mcan.h, InitPhase=INIT_ONE, ConfigType=vCan_30_Mcan_ConfigType, ConfigPtrClass=VCAN_30_MCAN_INIT_DATA, ConfigPtrName=vCan_30_Mcan_Config_Ptr, ModuleRef=vCan  # /ActiveEcuC/vCan PLAIN_TEXT Init function description of vCan_30_Mcan in UnfilteredViewInInvariantProject (UnfilteredInvariantProjectModelView) .
          vCan_30_Mcan_InitMemory: Header=vCan_30_Mcan.h, InitPhase=INIT_MEMORY, ModuleRef=vCan  # /ActiveEcuC/vCan PLAIN_TEXT InitMemory function description of vCan_30_Mcan in UnfilteredViewInInvariantProject (UnfilteredInvariantProjectModelView) .
          Brs_Init: Header=, InitPhase=NO_INIT, ModuleRef=vBRS  # /ActiveEcuC/vBRS PLAIN_TEXT Automatically generated by BswInitFctConfigurationService.
          vBaseEnv_Init: Header=, InitPhase=NO_INIT, ModuleRef=vBaseEnv  # /ActiveEcuC/vBaseEnv PLAIN_TEXT Created vBaseEnv_Init by Extended Init XML Service
          vLinkGen_Init: Header=vLinkGen_Lcfg.h, InitPhase=NO_INIT, ModuleRef=vLinkGen  # /ActiveEcuC/vLinkGen PLAIN_TEXT Dummy initialization of the vLinkGen
          McalLib_Init: Header=McalLib.h, InitPhase=NO_INIT, ModuleRef=McalLib  # /McalLib/McalLib PLAIN_TEXT Created McalLib_Init by Extended Init XML Service
          ResourceM_Init: Header=ResourceM.h, InitPhase=NO_INIT, ModuleRef=ResourceM  # /ResourceM/ResourceM PLAIN_TEXT Created ResourceM_Init by Extended Init XML Service
          Dio_Init: Header=Dio.h, InitPhase=NO_INIT, ModuleRef=Dio  # /ActiveEcuC/Dio PLAIN_TEXT Created Dio_Init by Extended Init XML Service
          Mcu_Init: Header=Mcu.h, InitPhase=INIT_ONE_EARLY, ConfigType=Mcu_ConfigType, ConfigPtrClass=AUTOMATIC, ConfigPtrName=&Mcu_Config, AdditionalInitCode=Mcu_InitClock(0);while (MCU_PLL_LOCKED != Mcu_GetPllStatus());Mcu_DistributePllClock();, ModuleRef=Mcu  # /Mcu/Mcu PLAIN_TEXT Created Mcu_Init by Extended Init XML Service
          Adc_Init: Header=Adc.h, InitPhase=INIT_ONE_LATE, ConfigType=Adc_ConfigType, ConfigPtrClass=AUTOMATIC, ConfigPtrName=&Adc_Config, ModuleRef=Adc  # /Adc/Adc PLAIN_TEXT Created Adc_Init by Extended Init XML Service
          Port_Init: Header=Port.h, InitPhase=INIT_ONE_EARLY, ConfigType=Port_ConfigType, ConfigPtrClass=AUTOMATIC, ConfigPtrName=&Port_Config, ModuleRef=Port  # /Port/Port PLAIN_TEXT Created Port_Init by Extended Init XML Service
          Irq_Init: Header=Irq.h, InitPhase=NO_INIT, ModuleRef=Irq  # /ActiveEcuC/Irq PLAIN_TEXT Created Irq_Init by Extended Init XML Service
          Dcm_Init: Header=Dcm.h, InitPhase=INIT_TWO_POST_NVMREADALL, ConfigType=Dcm_ConfigType, ConfigPtrClass=DCM_CONST, ConfigPtrName=NULL_PTR, ModuleRef=Dcm  # /ActiveEcuC/Dcm PLAIN_TEXT Dcm_Init function description
          Dcm_InitMemory: Header=Dcm.h, InitPhase=INIT_MEMORY, ModuleRef=Dcm  # /ActiveEcuC/Dcm PLAIN_TEXT Dcm_InitMemory function description
          CanTp_Init: Header=CanTp.h, InitPhase=INIT_TWO_TP, ConfigType=CanTp_PBConfigType, ConfigPtrClass=CANTP_INIT_DATA, ConfigPtrName=CanTp_Config_Ptr, ModuleRef=CanTp  # /ActiveEcuC/CanTp PLAIN_TEXT Init function description of CanTp in UnfilteredViewInInvariantProject (UnfilteredInvariantProjectModelView) .
          CanTp_PreInit: Header=CanTp.h, InitPhase=INIT_ONE, ConfigType=CanTp_PBConfigType, ConfigPtrClass=CANTP_INIT_DATA, ConfigPtrName=CanTp_Config_Ptr, ModuleRef=CanTp  # /ActiveEcuC/CanTp PLAIN_TEXT PreInit function description of CanTp in UnfilteredViewInInvariantProject (UnfilteredInvariantProjectModelView) .
          CanTp_InitMemory: Header=CanTp.h, InitPhase=INIT_MEMORY, ModuleRef=CanTp  # /ActiveEcuC/CanTp PLAIN_TEXT InitMemory function description of CanTp in UnfilteredViewInInvariantProject (UnfilteredInvariantProjectModelView) .
          Fee_Init: Header=Fee.h, InitPhase=INIT_ONE_LATE, ConfigType=Fee_ConfigType, ConfigPtrClass=AUTOMATIC, ConfigPtrName=&Fee_Config, ModuleRef=Fee  # /ActiveEcuC/Fee PLAIN_TEXT Created Fee_Init by Extended Init XML Service
          Fls_17_Dmu_Init: Header=Fls_17_Dmu.h, InitPhase=INIT_ONE, ConfigType=Fls_17_Dmu_ConfigType, ConfigPtrClass=AUTOMATIC, ConfigPtrName=&Fls_17_Dmu_Config, ModuleRef=Fls  # /ActiveEcuC/Fls PLAIN_TEXT Created Fls_17_Dmu_Init by Extended Init XML Service
          NvM_Init: Header=NvM.h, InitPhase=INIT_TWO_SYS, ModuleRef=NvM  # /ActiveEcuC/NvM PLAIN_TEXT Initialization of the NVRAM Manager, to make it ready for NvM_ReadAll being requested
      PostbuildLoadable: AlignmentFillPattern=0, PBROMStartAddress=0, PBRAMStartAddress=0, PBROMEndAddress=0, PBRAMEndAddress=0
    EcucHardware
      EcucCoreDefinition: EcucCoreId=0
