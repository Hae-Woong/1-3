AUTOSAR XML (schema 00049)
package /ResourceM
  module config ResourceM: implementation-config-variant=VARIANT-PRE-COMPILE
    ResourceMMcalConfig_0 (ResourceMMcalConfig): ResourceMMasterCore=CORE0, ResourceMNumberOfActiveCores=1
      ResourceMMcalCore_0 (ResourceMMcalCore): ResourceMCoreID=CORE0
