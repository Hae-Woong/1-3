AUTOSAR XML (schema 00049)
package /ActiveEcuC
  module config CanIf: implementation-config-variant=VARIANT-PRE-COMPILE, module-description=CanIf_Impl
    CanIfPrivateCfg:
      CanIfPrivateSoftwareFilterType = LINEAR
      CanIfPrivateDlcCheck = true
      CanIfSupportTTCAN = false
      CanIfTransceiverMapping = false
      CanIfTransceiverHandling = false
      CanIfSupportExtendedIds = false
      CanIfSupportNmOsek = false
      CanIfWakeupSupport = true
      CanIfStaticFdTxBufferSupport = false
      CanIfRxSearchConsiderMsgType = false
      CanIfTxBufferFifoSupport = false
      CanIfSetPduReceptionModeSupport = false
      CanIfTxBufferPrioByCanIdSupport = true
      CanIfSupportCanXL = false
      CanIfDataChecksumRxSupport = false
      CanIfDataChecksumTxSupport = false
    CanIfPublicCfg:
      CanIfPublicPnSupport = false
      CanIfPublicCancelTransmitSupport = false
      CanIfPublicDevErrorDetect = true
      CanIfPublicHandleTypeEnum = UINT8
      CanIfPublicMultipleDrvSupport = false
      CanIfPublicNumberOfCanHwUnits = 1
      CanIfPublicReadRxPduDataApi = false
      CanIfPublicReadRxPduNotifyStatusApi = false
      CanIfPublicReadTxPduNotifyStatusApi = false
      CanIfPublicSetDynamicTxIdApi = false
      CanIfPublicTxBuffering = true
      CanIfPublicTxConfirmPollingSupport = false
      CanIfPublicVersionInfoApi = true
      CanIfPublicWakeupCheckValidSupport = true
      CanIfPnWakeupTxPduFilterSupport = false
      CanIfPnTrcvHandlingSupport = false
      CanIfJ1939DynAddrSupport = DISABLED
      CanIfSafeBswChecks = false
      CanIfBusMirroringSupport = false
      CanIfEnableSecurityEventReporting = false
      CanIfSupportMultipartition = false
      CanIfPublicSetDynamicRxIdApi = false
      CanIfSetBaudrateApi = true
    CanIfInitCfg
      LightSwitch_oCAN00_042dae16_Rx (CanIfRxPduCfg):
        CanIfRxPduCanId = 528
        CanIfRxPduCanIdType = STANDARD_CAN
        CanIfRxPduDlc = 2
        CanIfRxPduUserRxIndicationName = PduR_CanIfRxIndication
        CanIfRxPduUserRxIndicationUL = PDUR
        CanIfRxPduId = 2
        CanIfRxPduReadData = false
        CanIfRxPduReadNotifyStatus = false
        CanIfRxPduDlcCheck = true
        CanIfRxPduType = STATIC
        CanIfRxPduCanHandleTypeLocked = false
        CanIfRxPduHrhIdRef = CN_CAN00_e8c1d35b_Rx_Std
        CanIfRxPduRef = LightSwitch_oCAN00_8d4de26e_Rx
      CanIfBufferCfg_Tx_Std_0fb271d2 (CanIfBufferCfg):
        CanIfBufferSize = 2
        CanIfTxBufferHandlingType = PRIO_BY_CANID
        CanIfTxBufferMappedTxPdus = 2
        CanIfTxBufferMaxPduLength = 8
        CanIfBufferHthRef = CN_CAN00_a2373004_Tx
      LightCtrl_oCAN00_d9f1a7da_Tx (CanIfTxPduCfg):
        CanIfTxPduCanId = 616
        CanIfTxPduCanIdType = STANDARD_CAN
        CanIfTxPduDlc = 8
        CanIfTxPduUserTxConfirmationName = NULL_PTR
        CanIfTxPduUserTxConfirmationUL = NONE
        CanIfTxPduId = 1
        CanIfTxPduReadNotifyStatus = false
        CanIfTxPduType = STATIC
        CanIfTxPduTruncation = true
        CanIfTxPduBufferRef = CanIfBufferCfg_Tx_Std_0fb271d2
        CanIfTxPduRef = LightCtrl_oCAN00_0afee19e_Tx
      CanIfInitHohCfg: CanIfInitRefCfgSet=CanConfigSet
        CN_CAN00_e8c1d35b_Rx_Std (CanIfHrhCfg): CanIfHrhSoftwareFilter=true, CanIfHrhCanCtrlIdRef=CT_CAN00_6199f384, CanIfHrhIdSymRef=CN_CAN00_e8c1d35b_Rx_Std
        CN_CAN00_a2373004_Tx (CanIfHthCfg): CanIfHthCanCtrlIdRef=CT_CAN00_6199f384, CanIfHthIdSymRef=CN_CAN00_a2373004_Tx
        CanIfHrhCfg: CanIfHrhSoftwareFilter=true, CanIfHrhCanCtrlIdRef=CT_CAN00_6199f384, CanIfHrhIdSymRef=CN_CAN00_193527e3_Rx
      Msg_Diag_Request_BFC_Tp_oCAN00_27733d79_Rx (CanIfRxPduCfg):
        CanIfRxPduCanId = 1442
        CanIfRxPduCanIdType = STANDARD_CAN
        CanIfRxPduDlc = 8
        CanIfRxPduUserRxIndicationName = CanTp_RxIndication
        CanIfRxPduUserRxIndicationType = PDUID_PDUINFOPTR
        CanIfRxPduUserRxIndicationUL = CAN_TP
        CanIfRxPduId = 1
        CanIfRxPduReadData = false
        CanIfRxPduReadNotifyStatus = false
        CanIfRxPduDlcCheck = true
        CanIfRxPduType = STATIC
        CanIfRxPduHrhIdRef = CN_CAN00_e8c1d35b_Rx_Std
        CanIfRxPduRef = Msg_Diag_Request_BFC_Tp_oCAN00_ebe478a8_Rx
      Msg_Diag_Response_BFC_Tp_oCAN00_be6a9846_Tx (CanIfTxPduCfg):
        CanIfTxPduCanId = 1458
        CanIfTxPduCanIdType = STANDARD_CAN
        CanIfTxPduDlc = 8
        CanIfTxPduUserTxConfirmationName = CanTp_TxConfirmation
        CanIfTxPduUserTxConfirmationUL = CAN_TP
        CanIfTxPduId = 0
        CanIfTxPduReadNotifyStatus = false
        CanIfTxPduType = STATIC
        CanIfTxPduTruncation = true
        CanIfTxPduBufferRef = CanIfBufferCfg_Tx_Std_0fb271d2
        CanIfTxPduRef = Msg_Diag_Response_BFC_Tp_oCAN00_2e02c5db_Tx
      Msg_Diag_Request_Global_Tp_oCAN00_ea5f45d3_Rx (CanIfRxPduCfg):
        CanIfRxPduCanId = 1913
        CanIfRxPduCanIdType = STANDARD_CAN
        CanIfRxPduDlc = 8
        CanIfRxPduUserRxIndicationName = CanTp_RxIndication
        CanIfRxPduUserRxIndicationType = PDUID_PDUINFOPTR
        CanIfRxPduUserRxIndicationUL = CAN_TP
        CanIfRxPduId = 0
        CanIfRxPduReadData = false
        CanIfRxPduReadNotifyStatus = false
        CanIfRxPduDlcCheck = true
        CanIfRxPduType = STATIC
        CanIfRxPduHrhIdRef = CN_CAN00_e8c1d35b_Rx_Std
        CanIfRxPduRef = Msg_Diag_Request_Global_Tp_oCAN00_eed4c6c0_Rx
    CanIfDispatchCfg:
      CanIfDispatchUserCtrlBusOffName = CanSM_ControllerBusOff
      CanIfDispatchUserCtrlBusOffUL = CAN_SM
      CanIfDispatchUserCtrlModeIndicationName = CanSM_ControllerModeIndication
      CanIfDispatchUserCtrlModeIndicationUL = CAN_SM
      CanIfDispatchUserValidateWakeupEventUL = ECUM
      CanIfDispatchUserValidateWakeupEventName = EcuM_ValidateWakeupEvent
    CanIfCtrlDrvCfg_7d254554 (CanIfCtrlDrvCfg):
      CanIfCtrlDrvTxCancellation = false
      CanIfCtrlDrvArVersion = CAN_DRV_EQC_MSRC
      CanIfCtrlDrvInitHohConfigRef = CanIfInitHohCfg
      CanIfCtrlDrvNameRef = CanGeneral
      CT_CAN00_6199f384 (CanIfCtrlCfg): CanIfCtrlId=0, CanIfCtrlWakeupSupport=false, CanIfCtrlJ1939DynAddrSupport=DISABLED, CanIfCtrlCanCtrlRef=CT_CAN00_6199f384
