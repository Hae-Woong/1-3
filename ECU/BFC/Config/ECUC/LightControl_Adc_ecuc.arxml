AUTOSAR XML (schema 00049)
package /Adc
  module config Adc: implementation-config-variant=VARIANT-POST-BUILD, module-description=Adc_Impl
    AdcConfigSet: AdcSyncClockDisable=false, AdcSystemClock=McuClockReferencePointConfig
      AdcGlobalInputClass_0 (AdcGlobalInputClass):
        AdcChConvMode = ADC_NOISE_REDUCTION_STEPS_0
        AdcChPreChargeClkCycles = ADC_INPUT_PRECHARGE_CYCLES_0
        AdcChSESPSEnable = false
        AdcChSampleTime = 0
        AdcEmuxChConvMode = ADC_NOISE_REDUCTION_STEPS_0
        AdcEmuxChPreChargeClkCycles = ADC_INPUT_PRECHARGE_CYCLES_0
        AdcEmuxChSESPSEnable = false
        AdcEmuxChSampleTime = 0
      AdcGlobalInputClass_1 (AdcGlobalInputClass):
        AdcChConvMode = ADC_NOISE_REDUCTION_STEPS_0
        AdcChPreChargeClkCycles = ADC_INPUT_PRECHARGE_CYCLES_0
        AdcChSESPSEnable = false
        AdcChSampleTime = 0
        AdcEmuxChConvMode = ADC_NOISE_REDUCTION_STEPS_0
        AdcEmuxChPreChargeClkCycles = ADC_INPUT_PRECHARGE_CYCLES_0
        AdcEmuxChSESPSEnable = false
        AdcEmuxChSampleTime = 0
      AdcHwUnit_0 (AdcHwUnit):
        AdcAnalogClockSyncDelay = 0
        AdcCalibrationSampleTime = ADC_CAL_TIME_2_TIMES_TADCI
        AdcHwUnitId = HWUNIT_ADC0
        AdcIdlePrechargeEnable = false
        AdcInputBufferEnable = true
        AdcMSBDoubleClkEnable = false
        AdcPostCalibrationDisable = false
        AdcPrechargeReference = ADC_VDD_VSM_USED
        AdcPrescale = 4
        AdcReferencePrechargePhases = ADC_PRECHARGE_PHASE_1
        AdcRequestSource{0..2}ConvMode = ADC_WAIT_FOR_START_MODE
        AdcSampleSyncEnable = false
        AdcSyncConvMode = ADC_STAND_ALONE
        AdcLightIntensity (AdcChannel):
          AdcAnChannelNum = G0CH7
          AdcBWDEnable = false
          AdcBWDPrechargeLevel = ADC_BWD_PRECH_VAGND
          AdcChannelId = 0
          AdcConverterDiagnosticEnable = false
          AdcConverterDiagnosticsLevel = ADC_CD_PULL_DEVICE_VDDM
          AdcInputClassSelection = ADC_HWUNIT_CLASS_0
          AdcMultiplexerDiagnosticEnable = false
          AdcMultiplexerDiagnosticLevel = ADC_MD_PULL_DOWN
          AdcPullDownDiagnosticEnable = false
          AdcSyncConvChannelEnable = false
          AdcChannelConvTime = 1000
        AdcGroupLight (AdcGroup):
          AdcChannel0Alias = 0
          AdcChannel1Alias = 1
          AdcEmuxChGroup = false
          AdcEmuxStartSelection = 0
          AdcGroupAccessMode = ADC_ACCESS_MODE_SINGLE
          AdcGroupConversionMode = ADC_CONV_MODE_ONESHOT
          AdcGroupId = 0
          AdcGroupTriggSrc = ADC_TRIGG_SRC_SW
          AdcHwExtGateSelect = ADC_GATE_NONE
          AdcHwExtTrigSelect = ADC_TRIG_NONE
          AdcHwGateSignal = ADC_GATE_LVL_HIGH
          AdcResRegDefinition = 0
          AdcStreamingBufferMode = ADC_STREAM_BUFFER_LINEAR
          AdcStreamingNumSamples = 1
          AdcGroupDefinition = AdcLightIntensity
        AdcHwUnitInputClass_0 (AdcHwUnitInputClass):
          AdcChConvMode = ADC_NOISE_REDUCTION_STEPS_0
          AdcChPreChargeClkCycles = ADC_INPUT_PRECHARGE_CYCLES_0
          AdcChSESPSEnable = false
          AdcChSampleTime = 0
          AdcEmuxChConvMode = ADC_NOISE_REDUCTION_STEPS_0
          AdcEmuxChPreChargeClkCycles = ADC_INPUT_PRECHARGE_CYCLES_0
          AdcEmuxChSESPSEnable = false
          AdcEmuxChSampleTime = 0
        AdcHwUnitInputClass_1 (AdcHwUnitInputClass):
          AdcChConvMode = ADC_NOISE_REDUCTION_STEPS_0
          AdcChPreChargeClkCycles = ADC_INPUT_PRECHARGE_CYCLES_0
          AdcChSESPSEnable = false
          AdcChSampleTime = 0
          AdcEmuxChConvMode = ADC_NOISE_REDUCTION_STEPS_0
          AdcEmuxChPreChargeClkCycles = ADC_INPUT_PRECHARGE_CYCLES_0
          AdcEmuxChSESPSEnable = false
          AdcEmuxChSampleTime = 0
    AdcGeneral:
      AdcDeInitApi = false
      AdcDevErrorDetect = true
      AdcEmuxEnable = false
      AdcEmuxGroupInterface0 = HWUNIT_ADC0
      AdcEmuxGroupInterface1 = HWUNIT_ADC1
      AdcEnableLimitCheck = false
      AdcEnableQueuing = false
      AdcEnableStartStopGroupApi = true
      AdcGrpNotifCapability = true
      AdcHwTriggerApi = false
      AdcInitCheckApi = true
      AdcInitDeInitApiMode = ADC_MCAL_SUPERVISOR
      AdcMaxChConvTimeCount = 0
      AdcMultiCoreErrorDetect = false
      AdcPriorityImplementation = ADC_PRIORITY_NONE
      AdcReadGroupApi = true
      AdcResultAlignment = ADC_ALIGN_RIGHT
      AdcResultHandlingImplementation = ADC_INTERRUPT_MODE_RESULT_HANDLING
      AdcRunTimeErrorDetect = true
      AdcRuntimeApiMode = ADC_MCAL_SUPERVISOR
      AdcSafetyEnable = false
      AdcSleepMode = ADC_SLEEP_MODE_REJECT
      AdcStartupCalibApi = false
      AdcSupplyVoltage = ADC_VOLTAGE_3P3V
      AdcSyncConvEnable = false
      AdcTriggerOneConversionEnable = false
      AdcVersionInfoApi = false
    AdcPublishedInformation: AdcChannelValueSigned=false, AdcGroupFirstChannelFixed=false, AdcMaxChannelResolution=12
    CommonPublishedInformation:
      ArMajorVersion = 4
      ArMinorVersion = 4
      ArPatchVersion = 0
      ModuleId = 123
      Release = _TRICORE_TC397_ADAS
      SwMajorVersion = 20
      SwMinorVersion = 25
      SwPatchVersion = 0
      VendorId = 17
