AUTOSAR XML (schema 00049)
package /ActiveEcuC
  module config VTTvSet: implementation-config-variant=VARIANT-PRE-COMPILE, module-description=VTTvSet_Impl
    vSetPlatform:
      vSetBitOrder = LSB_to_MSB
      vSetSizeOfEnum = Size32Bit
      vSetSizeOfRAMPointer = Size32Bit
      vSetSizeOfROMPointer = Size32Bit
      vSetByteOrder = LITTLE_ENDIAN
      vSetCPUType = CPU32Bit
      vSetSizeOfInt = Size32Bit
    vSetGeneral: vSetDummyStatementKind=None
    vSetCalibration
    vSetBswInitialization
      50 x vSetInitFunction:
        CanIf_InitMemory: vSetHeader=CanIf.h, vSetModuleRef=CanIf
          vSetInitFunctionInstance: vSetInitPhase=INIT_MEMORY
        PduR_PreInit: vSetHeader=PduR.h, vSetConfigType=PduR_PBConfigType, vSetConfigPtrClass=PDUR_INIT_DATA, vSetModuleRef=PduR
          vSetInitFunctionInstance: vSetInitPhase=INIT_ONE, vSetConfigPtrName=PduR_Config_Ptr
        Com_InitMemory: vSetHeader=Com.h, vSetModuleRef=Com
          vSetInitFunctionInstance: vSetInitPhase=INIT_MEMORY
        PduR_InitMemory: vSetHeader=PduR.h, vSetModuleRef=PduR
          vSetInitFunctionInstance: vSetInitPhase=INIT_MEMORY
        Dem_PreInit: vSetHeader=Dem.h, vSetConfigType=Dem_ConfigType, vSetConfigPtrClass=DEM_INIT_DATA, vSetModuleRef=Dem
          vSetInitFunctionInstance: vSetInitPhase=INIT_ZERO, vSetConfigPtrName=Dem_Config_Ptr
        CanSM_Init: vSetHeader=CanSM_EcuM.h, vSetConfigType=CanSM_ConfigType, vSetConfigPtrClass=CANSM_INIT_DATA, vSetModuleRef=CanSM
          vSetInitFunctionInstance: vSetInitPhase=INIT_TWO_SM, vSetConfigPtrName=CanSM_Config_Ptr
        Rte_InitMemory: vSetHeader=Rte_Main.h, vSetModuleRef=Rte
          vSetInitFunctionInstance: vSetInitPhase=INIT_MEMORY
        ComM_PostInit: vSetHeader=ComM.h, vSetModuleRef=ComM
          vSetInitFunctionInstance: vSetInitPhase=INIT_THREE
        CanIf_Init: vSetHeader=CanIf.h, vSetConfigPtrClass=CANIF_INIT_DATA, vSetConfigType=CanIf_ConfigType, vSetModuleRef=CanIf
          vSetInitFunctionInstance: vSetInitPhase=INIT_TWO_IF, vSetConfigPtrName=CanIf_Config_Ptr
        CanSM_InitMemory: vSetHeader=CanSM_EcuM.h, vSetModuleRef=CanSM
          vSetInitFunctionInstance: vSetInitPhase=INIT_MEMORY
        PduR_Init: vSetHeader=PduR.h, vSetConfigType=PduR_PBConfigType, vSetConfigPtrClass=PDUR_INIT_DATA, vSetModuleRef=PduR
          vSetInitFunctionInstance: vSetInitPhase=INIT_TWO_COM, vSetConfigPtrName=PduR_Config_Ptr
        Rte_Start: vSetHeader=Rte_Main.h, vSetModuleRef=Rte
          vSetInitFunctionInstance: vSetInitPhase=INIT_THREE
        Rte_StartTiming: vSetHeader=Rte_Main.h, vSetModuleRef=Rte
          vSetInitFunctionInstance: vSetInitPhase=NO_INIT
        BswM_Init: vSetHeader=BswM.h, vSetConfigPtrClass=BSWM_INIT_DATA, vSetConfigType=BswM_ConfigType, vSetModuleRef=BswM
          vSetInitFunctionInstance: vSetInitPhase=NO_INIT, vSetConfigPtrName=BswM_Config_Ptr
        Dem_Init: vSetHeader=Dem.h, vSetConfigPtrClass=DEM_INIT_DATA, vSetConfigType=Dem_ConfigType, vSetModuleRef=Dem
          vSetInitFunctionInstance: vSetInitPhase=INIT_TWO_POST_NVMREADALL, vSetConfigPtrName=Dem_Config_Ptr
        ComM_PreInit: vSetHeader=ComM.h, vSetConfigPtrClass=COMM_INIT_DATA, vSetConfigType=ComM_ConfigType, vSetModuleRef=ComM
          vSetInitFunctionInstance: vSetInitPhase=INIT_ONE, vSetConfigPtrName=ComM_Config_Ptr
        SchM_StartTiming: vSetHeader=Rte_Main.h, vSetModuleRef=Rte
          vSetInitFunctionInstance: vSetInitPhase=NO_INIT
        Det_InitMemory: vSetHeader=Det.h, vSetModuleRef=Det
          vSetInitFunctionInstance: vSetInitPhase=INIT_MEMORY
        Dem_InitMemory: vSetHeader=Dem.h, vSetModuleRef=Dem
          vSetInitFunctionInstance: vSetInitPhase=INIT_MEMORY
        ComM_InitMemory: vSetHeader=ComM.h, vSetModuleRef=ComM
          vSetInitFunctionInstance: vSetInitPhase=INIT_MEMORY
        SchM_Init: vSetHeader=Rte_Main.h, vSetModuleRef=Rte
          vSetInitFunctionInstance: vSetInitPhase=NO_INIT
        SchM_Start: vSetHeader=Rte_Main.h, vSetModuleRef=Rte
          vSetInitFunctionInstance: vSetInitPhase=NO_INIT
        ComM_Init: vSetHeader=ComM.h, vSetConfigPtrClass=COMM_INIT_DATA, vSetConfigType=ComM_ConfigType, vSetModuleRef=ComM
          vSetInitFunctionInstance: vSetInitPhase=INIT_TWO_POST_NVMREADALL, vSetConfigPtrName=ComM_Config_Ptr
        BswM_PreInit: vSetHeader=BswM.h, vSetConfigType=BswM_ConfigType, vSetConfigPtrClass=BSWM_INIT_DATA, vSetModuleRef=BswM
          vSetInitFunctionInstance: vSetInitPhase=INIT_ONE, vSetConfigPtrName=BswM_Config_Ptr
        BswM_InitMemory: vSetHeader=BswM.h, vSetModuleRef=BswM
          vSetInitFunctionInstance: vSetInitPhase=INIT_MEMORY
        Com_Init: vSetHeader=Com.h, vSetConfigPtrClass=COM_INIT_DATA, vSetConfigType=Com_ConfigType, vSetModuleRef=Com
          vSetInitFunctionInstance: vSetInitPhase=INIT_TWO_COM, vSetConfigPtrName=Com_Config_Ptr
        EcuM_Init: vSetHeader=EcuM.h, vSetConfigPtrClass=ECUM_INIT_DATA, vSetConfigType=EcuM_PbConfigType, vSetModuleRef=EcuM
          vSetInitFunctionInstance: vSetInitPhase=NO_INIT, vSetConfigPtrName=EcuM_Config_Ptr
        Det_Init: vSetHeader=Det.h, vSetConfigPtrClass=DET_INIT_DATA, vSetConfigType=Det_ConfigType, vSetModuleRef=Det
          vSetInitFunctionInstance: vSetInitPhase=INIT_ZERO, vSetConfigPtrName=Det_Config_Ptr
        Can_30_Core_InitMemory: vSetHeader=Can_30_Core.h, vSetModuleRef=VTTCan
          vSetInitFunctionInstance: vSetInitPhase=INIT_MEMORY
        Can_30_Core_Init: vSetHeader=Can_30_Core.h, vSetConfigType=Can_30_Core_ConfigType, vSetConfigPtrClass=CAN_30_CORE_INIT_DATA, vSetModuleRef=VTTCan
          vSetInitFunctionInstance: vSetInitPhase=INIT_TWO_DRV, vSetConfigPtrName=Can_30_Core_Config_Ptr
        vCan_30_Mcan_Init: vSetHeader=vCan_30_Mcan.h, vSetConfigType=vCan_30_Mcan_ConfigType, vSetConfigPtrClass=VCAN_30_MCAN_INIT_DATA, vSetModuleRef=vCan
          vSetInitFunctionInstance: vSetInitPhase=INIT_ONE, vSetConfigPtrName=vCan_30_Mcan_Config_Ptr
        vCan_30_Mcan_InitMemory: vSetHeader=vCan_30_Mcan.h, vSetModuleRef=vCan
          vSetInitFunctionInstance: vSetInitPhase=INIT_MEMORY
        vLinkGen_Init: vSetHeader=vLinkGen_Lcfg.h, vSetModuleRef=vLinkGen
          vSetInitFunctionInstance: vSetInitPhase=NO_INIT
        vBaseEnv_Init: vSetHeader=, vSetModuleRef=vBaseEnv
          vSetInitFunctionInstance: vSetInitPhase=NO_INIT
        Brs_Init: vSetHeader=, vSetModuleRef=vBRS
          vSetInitFunctionInstance: vSetInitPhase=NO_INIT
        McalLib_Init: vSetHeader=McalLib.h, vSetModuleRef=McalLib
          vSetInitFunctionInstance: vSetInitPhase=NO_INIT
        ResourceM_Init: vSetHeader=ResourceM.h, vSetModuleRef=ResourceM
          vSetInitFunctionInstance: vSetInitPhase=NO_INIT
        Dio_Init: vSetHeader=Dio.h, vSetModuleRef=VTTDio
          vSetInitFunctionInstance: vSetInitPhase=NO_INIT
        Mcu_Init: vSetHeader=Mcu.h, vSetConfigType=Mcu_ConfigType, vSetConfigPtrClass=AUTOMATIC, vSetModuleRef=Mcu
          vSetInitFunctionInstance:
            vSetInitPhase = INIT_ONE_EARLY
            vSetAdditionalInitCode = Mcu_InitClock(0);while (MCU_PLL_LOCKED != Mcu_GetPllStatus());Mcu_DistributePllClock();
            vSetConfigPtrName = &Mcu_Config
        Adc_Init: vSetHeader=Adc.h, vSetConfigPtrClass=AUTOMATIC, vSetConfigType=Adc_ConfigType, vSetModuleRef=Adc
          vSetInitFunctionInstance: vSetInitPhase=INIT_ONE_LATE, vSetConfigPtrName=&Adc_Config
        Port_Init: vSetHeader=Port.h, vSetConfigType=Port_ConfigType, vSetConfigPtrClass=AUTOMATIC, vSetModuleRef=Port
          vSetInitFunctionInstance: vSetInitPhase=INIT_ONE_EARLY, vSetConfigPtrName=&Port_Config
        Irq_Init: vSetHeader=Irq.h, vSetModuleRef=Irq
          vSetInitFunctionInstance: vSetInitPhase=NO_INIT
        Dcm_InitMemory: vSetHeader=Dcm.h, vSetModuleRef=Dcm
          vSetInitFunctionInstance: vSetInitPhase=INIT_MEMORY
        Dcm_Init: vSetHeader=Dcm.h, vSetConfigPtrClass=DCM_CONST, vSetConfigType=Dcm_ConfigType, vSetModuleRef=Dcm
          vSetInitFunctionInstance: vSetInitPhase=INIT_TWO_POST_NVMREADALL, vSetConfigPtrName=NULL_PTR
        CanTp_InitMemory: vSetHeader=CanTp.h, vSetModuleRef=CanTp
          vSetInitFunctionInstance: vSetInitPhase=INIT_MEMORY
        CanTp_Init: vSetHeader=CanTp.h, vSetConfigType=CanTp_PBConfigType, vSetConfigPtrClass=CANTP_INIT_DATA, vSetModuleRef=CanTp
          vSetInitFunctionInstance: vSetInitPhase=INIT_TWO_TP, vSetConfigPtrName=CanTp_Config_Ptr
        CanTp_PreInit: vSetHeader=CanTp.h, vSetConfigPtrClass=CANTP_INIT_DATA, vSetConfigType=CanTp_PBConfigType, vSetModuleRef=CanTp
          vSetInitFunctionInstance: vSetInitPhase=INIT_ONE, vSetConfigPtrName=CanTp_Config_Ptr
        Fee_Init: vSetHeader=Fee.h, vSetConfigType=Fee_ConfigType, vSetConfigPtrClass=AUTOMATIC, vSetModuleRef=Fee
          vSetInitFunctionInstance: vSetInitPhase=INIT_ONE_LATE, vSetConfigPtrName=&Fee_Config
        Fls_17_Dmu_Init: vSetHeader=Fls_17_Dmu.h, vSetConfigType=Fls_17_Dmu_ConfigType, vSetConfigPtrClass=AUTOMATIC, vSetModuleRef=VTTFls
          vSetInitFunctionInstance: vSetInitPhase=INIT_ONE, vSetConfigPtrName=&Fls_17_Dmu_Config
        NvM_Init: vSetHeader=NvM.h, vSetModuleRef=NvM
          vSetInitFunctionInstance: vSetInitPhase=INIT_TWO_SYS
