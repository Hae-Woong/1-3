AUTOSAR XML (schema 00049)
package /ActiveEcuC
  module config vCan: implementation-config-variant=VARIANT-PRE-COMPILE, module-description=vCan_Impl
    vCanGeneral:
      vCanUseNestedCANInterrupts = false
      vCanFdPed = false
      vCanMcanRevision = M_CAN_REV_315
      vCanUseVirtualAddressing = false
      vCanInitializationOfMessageRam = true
      vCanFdNiso = false
      vCanConstantDataToDefine = true
      vCanUseTransmitterDelayCompensationFilterWindow = false
      vCanGeneralSetting:
        vCanMixedRxBasicCANSupport = true
        vCanMultipleTxBasicCANSupport = true
        vCanRamCheckSupport = MailboxNotification
        vCanFdSupport = FULL
        vCanHardwareCancellationSupport = false
        vCanHardwareCancellationTaskSupport = false
        vCanHwTxFifoSupport = true
        vCanIndividualProcessingSupport = true
        vCanMixedFiltersSupport = false
        vCanMultipleFiltersPerBasicCANSupport = true
        vCanMultipleRxBasicCANSupport = true
        vCanMultiplexedTransmissionSupport = true
        vCanSilentModeSupport = true
        vCanUseOsInterruptControlSupport = true
        vCanWakeupSupport = false
        vCanCompatibilityVersion = 256
        vCanMultipartitionSupport = true
        vCanInterruptLockByDriverSupport = false
      vCan_30_Mcan_Loop_Init (vCanHardwareLoopCheck): vCanHardwareLoopCheckId=1
      vCan_30_Mcan_Loop_IrFlag (vCanHardwareLoopCheck): vCanHardwareLoopCheckId=2
      vCanAddOnMcMcan: vCanWorkaroundErratumH001=true
    vCanController:
      vCanBaudrateClock = 20000
      vCanPhysicalController = M_CAN0
      vCanTxBufferElementSize = ES_8
      vCanTxEventFifoBufferElementSize = ES_8
      vCanRxBufferElementSize = ES_8
      vCanRxFifo0ElementSize = ES_8
      vCanRxFifo1ElementSize = ES_8
      vCanMaxNrOfTxBuffers = 32
      vCanMaxNrOfTxEventFifoBuffers = 32
      vCanMaxNrOfRxBuffers = 64
      vCanMaxNrOfRxFifo0Elements = 64
      vCanMaxNrOfRxFifo1Elements = 64
      vCanIsTTCAN = true
      vCanStartAddressOfMessageRam = 4028628992
      vCanUsedMessageRam = 72
      vCanIsSharedMessageRam = false
      vCanBaudrateSetting:
        vCanBtlCyclesMin = 4
        vCanBtlCyclesMax = 385
        vCanPropSegMin = 0
        vCanPropSegMax = 256
        vCanSeg1Min = 2
        vCanSeg1Max = 256
        vCanSeg2Min = 2
        vCanSeg2Max = 128
        vCanSjwMin = 1
        vCanSjwMax = 128
        vCanBaudrateMin = 1000
        vCanBaudrateMax = 1000000
        vCanPrescalerMin = 1
        vCanPrescalerMax = 512
        vCanTSeg1Min = 2
        vCanTSeg1Max = 256
      vCanFdBaudrateSetting:
        vCanBtlCyclesMin = 4
        vCanBtlCyclesMax = 49
        vCanPropSegMin = 0
        vCanPropSegMax = 32
        vCanSeg1Min = 1
        vCanSeg1Max = 32
        vCanSeg2Min = 1
        vCanSeg2Max = 16
        vCanSjwMin = 1
        vCanSjwMax = 16
        vCanBaudrateMin = 1000
        vCanBaudrateMax = 16000000
        vCanPrescalerMin = 1
        vCanPrescalerMax = 32
        vCanTSeg1Min = 1
        vCanTSeg1Max = 32
      vCanFilterSettings: vCanFreeFilter=126, vCanFreeRxBasicCAN=0, vCanFreeRxFullCAN=64
      vCanAddOnMcMcan: vCanRxInputSelection=b_001
