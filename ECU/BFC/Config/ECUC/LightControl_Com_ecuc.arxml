AUTOSAR XML (schema 00049)
package /ActiveEcuC
  module config Com: implementation-config-variant=VARIANT-PRE-COMPILE, module-description=Com_Impl
    ComConfig: ComConfigurationId=0, ComRxDeferredNotificationCacheSize=0, ComRxImmediateNotificationCacheSize=0
      BFC_oCAN00_Tx_5d56b2ca (ComIPduGroup): ComIPduGroupHandleId=1
      BFC_oCAN00_Rx_0b0c154c (ComIPduGroup): ComIPduGroupHandleId=0
      LightSwitch_oLightSwitch_oCAN00_b775c021_Rx (ComSignal):
        ComBitPosition = 0
        ComBitSize = 2
        ComSignalDataInvalidValue = 3
        ComSignalEndianness = LITTLE_ENDIAN
        ComSignalInitValue = 0
        ComSignalType = UINT8
        ComTimeout = 0
        ComSignalAccess = ACCESS_NEEDED_BY_SWC_OR_COM
        ComHandleId = 0
        ComSystemTemplateSystemSignalRef = LightSwitch
      LightCtrl_oCAN00_2e88b3f5_Tx (ComIPdu):
        ComIPduDirection = SEND
        ComIPduType = NORMAL
        ComIPduHandleId = 0
        ComIPduSignalProcessing = DEFERRED
        ComIPduCancellationSupport = false
        ComIPduGroupRef = BFC_oCAN00_Tx_5d56b2ca
        ComIPduSignalRef = HeadLight_oLightCtrl_oCAN00_3d3756da_Tx
        ComPduIdRef = LightCtrl_oCAN00_2e88b3f5_Tx
        ComIPduMainFunctionRef = ComMainFunctionTx
        ComTxIPdu: ComMinimumDelayTime=0, ComTxIPduUnusedAreasDefault=0
          ComTxModeTrue
            ComTxMode: ComTxModeMode=PERIODIC, ComTxModeTimeOffset=0, ComTxModeTimePeriod=0.01
          ComTxModeFalse
            ComTxMode: ComTxModeMode=PERIODIC, ComTxModeTimeOffset=0, ComTxModeTimePeriod=0.01
      LightSwitch_oCAN00_d3b6d56e_Rx (ComIPdu):
        ComIPduDirection = RECEIVE
        ComIPduType = NORMAL
        ComIPduHandleId = 0
        ComIPduSignalProcessing = DEFERRED
        ComIPduCancellationSupport = false
        ComIPduGroupRef = BFC_oCAN00_Rx_0b0c154c
        ComIPduSignalRef = LightSwitch_oLightSwitch_oCAN00_b775c021_Rx
        ComPduIdRef = LightSwitch_oCAN00_d3b6d56e_Rx
        ComIPduMainFunctionRef = ComMainFunctionRx
      HeadLight_oLightCtrl_oCAN00_3d3756da_Tx (ComSignal):
        ComBitPosition = 0
        ComBitSize = 1
        ComSignalEndianness = LITTLE_ENDIAN
        ComSignalInitValue = 0
        ComSignalType = BOOLEAN
        ComTransferProperty = PENDING
        ComSignalAccess = ACCESS_NEEDED_BY_SWC_OR_COM
        ComHandleId = 0
        ComSystemTemplateSystemSignalRef = HeadLight
      ComMainFunctionRx: ComMainRxTimeBase=0.01, ComMainFunctionRxHandleId=0
      ComMainFunctionTx: ComMainTxTimeBase=0.01, ComMainFunctionTxHandleId=0
    ComGeneral:
      ComConfigurationUseDet = true
      ComSafeBswChecks = false
      ComEnableSignalGroupArrayApi = false
      ComRetryFailedTransmitRequests = true
      ComSupportedIPduGroups = 2
      ComVersionInfoApi = false
      ComMetaDataSupport = false
      ComDescriptionGateway = false
      ComStrictRepetitionPeriod = false
      ComMixedModePeriodicSuppression = false
      ComSignalGateway = NONE
      ComMultiPartition = false
    ComGeneration:
      ComOutOfBoundsWriteProtectionStrategy = NONE
      ComOutOfBoundsWriteSanitizer = false
      ComOutOfBoundsReadSanitizer = false
      ComReduceConstantData2Define = false
      ComBoolDataInArrayOfStructStrategy = BOOLEAN
      ComDeduplicateIndirectedData = true
      ComDataDeduplicationStrategy = WITH_CAST
      ComReduceBoolDataByNegationThreshold = 2
      ComReduceBoolDataByNumericalComparisonThreshold = 2
      ComReduceBoolDataByNumericalRelationThreshold = 2
      ComReduceBoolDataByNumericalOperandStrategy = WITH_ANY_VALUE
      ComReduceNumericalDataByOffsetThreshold = 2
      ComReduceNumericalDataByArraySubtractionThreshold = 2
      ComReduceDataByStreaming = false
      ComShortSymbols = false
      ComInterfacesForDeactivatedData = false
      ComReferringKeysInComments = false
      ComNumberOfElementsCommentThreshold = 1000
    ComOptimization:
      ComTxProcessingISRLockThreshold = 1
      ComRxProcessingISRLockThreshold = 1
      ComGatewayProcessingISRLockThreshold = 1
      ComGatewayDescriptionProcessingISRLockThreshold = 1
      ComIPduGroupISRLockThreshold = 1
