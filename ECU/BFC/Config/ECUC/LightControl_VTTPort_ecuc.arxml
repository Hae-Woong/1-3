AUTOSAR XML (schema 00049)
package /ActiveEcuC
  module config VTTPort: implementation-config-variant=VARIANT-PRE-COMPILE, module-description=VTTPort_Impl
    PortGeneral: PortDevErrorDetect=false, PortSetPinDirectionApi=false, PortSetPinModeApi=false, PortVersionInfoApi=false, PortSafeBswChecks=false
    PortConfigSet: Port_PinModeType=uint8, Port_PinType=uint8
      15 x PortContainer:
        PortContainer_5: PortNumberOfPortPins=11
          11 x PortPin, all with PortPinDirection=PORT_PIN_IN, PortPinDirectionChangeable=false, PortPinLevelValue=PORT_PIN_LEVEL_LOW, PortPinModeChangeable=false:
            PortPin_2: PortPinId=226
            PortPin_5: PortPinId=229
            PortPin_3: PortPinId=227
            PortPin_1: PortPinId=225
            PortPin_8: PortPinId=232
            PortPin_6: PortPinId=230
            PortPin_9: PortPinId=233
            PortPin_7: PortPinId=231
            PortPin_0: PortPinId=224
            PortPin_4: PortPinId=228
            PortPin_10: PortPinId=234
        PortContainer_1: PortNumberOfPortPins=9
          9 x PortPin, all with PortPinDirection=PORT_PIN_IN, PortPinDirectionChangeable=false, PortPinLevelValue=PORT_PIN_LEVEL_LOW, PortPinModeChangeable=false:
            PortPin_7: PortPinId=39
            PortPin_4: PortPinId=36
            PortPin_5: PortPinId=37
            PortPin_3: PortPinId=35
            PortPin_0: PortPinId=32
            PortPin_8: PortPinId=40
            PortPin_1: PortPinId=33
            PortPin_2: PortPinId=34
            PortPin_6: PortPinId=38
        PortContainer_8: PortNumberOfPortPins=8
          8 x PortPin, all with PortPinDirection=PORT_PIN_IN, PortPinDirectionChangeable=false, PortPinLevelValue=PORT_PIN_LEVEL_LOW, PortPinModeChangeable=false:
            PortPin_7: PortPinId=343
            PortPin_0: PortPinId=336
            PortPin_4: PortPinId=340
            PortPin_3: PortPinId=339
            PortPin_6: PortPinId=342
            PortPin_1: PortPinId=337
            PortPin_2: PortPinId=338
            PortPin_5: PortPinId=341
        PortContainer_10: PortNumberOfPortPins=8
          8 x PortPin, all with PortPinDirection=PORT_PIN_IN, PortPinDirectionChangeable=false, PortPinLevelValue=PORT_PIN_LEVEL_LOW, PortPinModeChangeable=false:
            PortPin_4: PortPinId=372
            PortPin_0: PortPinId=368
            PortPin_3: PortPinId=371
            PortPin_6: PortPinId=374
            PortPin_5: PortPinId=373
            PortPin_7: PortPinId=375
            PortPin_1: PortPinId=369
            PortPin_2: PortPinId=370
        PortContainer_2: PortNumberOfPortPins=9
          9 x PortPin, all with PortPinDirection=PORT_PIN_IN, PortPinDirectionChangeable=false, PortPinModeChangeable=false:
            PortPin_4: PortPinLevelValue=PORT_PIN_LEVEL_LOW, PortPinId=164
            PortPin_0: PortPinLevelValue=PORT_PIN_LEVEL_HIGH, PortPinId=160
            PortPin_5: PortPinLevelValue=PORT_PIN_LEVEL_LOW, PortPinId=165
            PortPin_3: PortPinLevelValue=PORT_PIN_LEVEL_LOW, PortPinId=163
            PortPin_2: PortPinLevelValue=PORT_PIN_LEVEL_LOW, PortPinId=162
            PortPin_6: PortPinLevelValue=PORT_PIN_LEVEL_LOW, PortPinId=166
            PortPin_1: PortPinLevelValue=PORT_PIN_LEVEL_LOW, PortPinId=161
            PortPin_7: PortPinLevelValue=PORT_PIN_LEVEL_LOW, PortPinId=167
            PortPin_8: PortPinLevelValue=PORT_PIN_LEVEL_LOW, PortPinId=168
        PortContainer_12: PortNumberOfPortPins=16
          16 x PortPin, all with PortPinDirection=PORT_PIN_IN, PortPinDirectionChangeable=false, PortPinLevelValue=PORT_PIN_LEVEL_LOW, PortPinModeChangeable=false:
            PortPin_15: PortPinId=543
            PortPin_10: PortPinId=538
            PortPin_14: PortPinId=542
            PortPin_6: PortPinId=534
            PortPin_3: PortPinId=531
            PortPin_12: PortPinId=540
            PortPin_7_DIO_Output_HeadLight: PortPinId=535
            PortPin_0: PortPinId=528
            PortPin_4: PortPinId=532
            PortPin_11: PortPinId=539
            PortPin_2: PortPinId=530
            PortPin_9: PortPinId=537
            PortPin_1: PortPinId=529
            PortPin_13: PortPinId=541
            PortPin_8: PortPinId=536
            PortPin_5: PortPinId=533
        PortContainer_9: PortNumberOfPortPins=12
          12 x PortPin, all with PortPinDirection=PORT_PIN_IN, PortPinDirectionChangeable=false, PortPinLevelValue=PORT_PIN_LEVEL_LOW, PortPinModeChangeable=false:
            PortPin_4: PortPinId=356
            PortPin_1: PortPinId=353
            PortPin_2: PortPinId=354
            PortPin_6: PortPinId=358
            PortPin_9: PortPinId=361
            PortPin_8: PortPinId=360
            PortPin_11: PortPinId=363
            PortPin_3: PortPinId=355
            PortPin_7: PortPinId=359
            PortPin_5: PortPinId=357
            PortPin_0: PortPinId=352
            PortPin_10: PortPinId=362
        PortContainer_0: PortNumberOfPortPins=13
          13 x PortPin, all with PortPinDirection=PORT_PIN_IN, PortPinDirectionChangeable=false, PortPinLevelValue=PORT_PIN_LEVEL_LOW, PortPinModeChangeable=false:
            PortPin_11: PortPinId=11
            PortPin_9: PortPinId=9
            PortPin_12: PortPinId=12
            PortPin_1: PortPinId=1
            PortPin_0: PortPinId=0
            PortPin_6: PortPinId=6
            PortPin_7: PortPinId=7
            PortPin_10: PortPinId=10
            PortPin_8: PortPinId=8
            PortPin_3: PortPinId=3
            PortPin_5: PortPinId=5
            PortPin_4: PortPinId=4
            PortPin_2: PortPinId=2
        PortContainer_6: PortNumberOfPortPins=9
          9 x PortPin, all with PortPinDirection=PORT_PIN_IN, PortPinDirectionChangeable=false, PortPinLevelValue=PORT_PIN_LEVEL_LOW, PortPinModeChangeable=false:
            PortPin_8: PortPinId=248
            PortPin_2: PortPinId=242
            PortPin_4: PortPinId=244
            PortPin_5: PortPinId=245
            PortPin_6: PortPinId=246
            PortPin_0: PortPinId=240
            PortPin_3: PortPinId=243
            PortPin_7: PortPinId=247
            PortPin_1: PortPinId=241
        PortContainer_4: PortNumberOfPortPins=2
          PortPin_1 (PortPin): PortPinDirection=PORT_PIN_IN, PortPinDirectionChangeable=false, PortPinLevelValue=PORT_PIN_LEVEL_LOW, PortPinModeChangeable=false, PortPinId=193
          PortPin_0 (PortPin): PortPinDirection=PORT_PIN_IN, PortPinDirectionChangeable=false, PortPinLevelValue=PORT_PIN_LEVEL_LOW, PortPinModeChangeable=false, PortPinId=192
        PortContainer_13: PortNumberOfPortPins=5
          5 x PortPin, all with PortPinDirection=PORT_PIN_IN, PortPinDirectionChangeable=false, PortPinLevelValue=PORT_PIN_LEVEL_LOW, PortPinModeChangeable=false:
            PortPin_4: PortPinId=549
            PortPin_0: PortPinId=545
            PortPin_2: PortPinId=547
            PortPin_1: PortPinId=546
            PortPin_3: PortPinId=548
        PortContainer_7: PortNumberOfPortPins=13
          13 x PortPin, all with PortPinDirection=PORT_PIN_IN, PortPinDirectionChangeable=false, PortPinLevelValue=PORT_PIN_LEVEL_LOW, PortPinModeChangeable=false:
            PortPin_0: PortPinId=320
            CAN0_TX: PortPinId=328
            PortPin_10: PortPinId=332
            PortPin_4: PortPinId=326
            PortPin_8: PortPinId=330
            PortPin_1: PortPinId=321
            PortPin_12: PortPinId=334
            PortPin_7: PortPinId=329
            PortPin_3: PortPinId=323
            PortPin_2: PortPinId=322
            PortPin_9: PortPinId=331
            CAN0_RX: PortPinId=327
            PortPin_11: PortPinId=333
        PortContainer_14: PortNumberOfPortPins=9
          9 x PortPin, all with PortPinDirection=PORT_PIN_IN, PortPinDirectionChangeable=false, PortPinLevelValue=PORT_PIN_LEVEL_LOW, PortPinModeChangeable=false:
            PortPin_8: PortPinId=652
            PortPin_3: PortPinId=647
            PortPin_2: PortPinId=646
            PortPin_1: PortPinId=641
            PortPin_0: PortPinId=640
            PortPin_4: PortPinId=648
            PortPin_6: PortPinId=650
            PortPin_7: PortPinId=651
            PortPin_5: PortPinId=649
        PortContainer_11: PortNumberOfPortPins=8
          8 x PortPin, all with PortPinDirection=PORT_PIN_IN, PortPinDirectionChangeable=false, PortPinLevelValue=PORT_PIN_LEVEL_LOW, PortPinModeChangeable=false:
            PortPin_3: PortPinId=515
            PortPin_4: PortPinId=516
            PortPin_1: PortPinId=513
            PortPin_7: PortPinId=519
            PortPin_5: PortPinId=517
            PortPin_2: PortPinId=514
            PortPin_6: PortPinId=518
            PortPin_0: PortPinId=512
        PortContainer_3: PortNumberOfPortPins=16
          16 x PortPin, all with PortPinDirection=PORT_PIN_IN, PortPinDirectionChangeable=false, PortPinLevelValue=PORT_PIN_LEVEL_LOW, PortPinModeChangeable=false:
            PortPin_14: PortPinId=190
            PortPin_6: PortPinId=182
            PortPin_15: PortPinId=191
            PortPin_7: PortPinId=183
            PortPin_5: PortPinId=181
            PortPin_4: PortPinId=180
            PortPin_2: PortPinId=178
            PortPin_8: PortPinId=184
            PortPin_0: PortPinId=176
            PortPin_3: PortPinId=179
            PortPin_9: PortPinId=185
            PortPin_12: PortPinId=188
            PortPin_1: PortPinId=177
            PortPin_13: PortPinId=189
            PortPin_11: PortPinId=187
            PortPin_10: PortPinId=186
