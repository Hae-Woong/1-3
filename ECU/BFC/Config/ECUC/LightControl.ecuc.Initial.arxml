AUTOSAR XML (schema 00049)
package /InitialEcuC
  ecuc value collection InitialEcuC: ecuc-values=[Can, CanIf, CanNm, CanSM, CanTp, Com, ComM, Dcm, Dem, EcuC, EcuM, Nm, PduR]
  module config Can
    CanConfigSet
      CT_CAN00_6199f384 (CanController):  # CAN00
        CanControllerActivation = true
        CanControllerDefaultBaudrate = CanControllerBaudrateConfig
        CanControllerSystemRef = CT_CAN00
        CanWakeupSourceRef = EcuMCommonConfiguration/CN_CAN00_a2373004
        CanControllerBaudrateConfig: CanControllerBaudRate=500
      CN_CAN00_193527e3_Rx (CanHardwareObject): CanHandleType=BASIC, CanIdType=STANDARD, CanIdValue=0, CanObjectType=RECEIVE, CanControllerRef=CanConfigSet/CT_CAN00_6199f384
      CN_CAN00_a2373004_Tx (CanHardwareObject): CanHandleType=BASIC, CanIdValue=0, CanObjectType=TRANSMIT, CanControllerRef=CanConfigSet/CT_CAN00_6199f384
    CanGeneral: CanIndex=0
  module config CanIf
    CanIfCtrlDrvCfg_7d254554 (CanIfCtrlDrvCfg): CanIfCtrlDrvInitHohConfigRef=CanIfInitHohCfg, CanIfCtrlDrvNameRef=CanGeneral
      CT_CAN00_6199f384 (CanIfCtrlCfg): CanIfCtrlCanCtrlRef=CanConfigSet/CT_CAN00_6199f384
    CanIfInitCfg
      CHNL_0fb271d2 (CanIfBufferCfg): CanIfBufferSize=0, CanIfBufferHthRef=CanIfInitHohCfg/CN_CAN00_a2373004_Tx
      CanIfInitHohCfg: CanIfInitRefCfgSet=CanConfigSet
        CN_CAN00_193527e3_Rx (CanIfHrhCfg): CanIfHrhCanCtrlIdRef=CanIfCtrlDrvCfg_7d254554/CT_CAN00_6199f384, CanIfHrhIdSymRef=CanConfigSet/CN_CAN00_193527e3_Rx
        CN_CAN00_a2373004_Tx (CanIfHthCfg): CanIfHthCanCtrlIdRef=CanIfCtrlDrvCfg_7d254554/CT_CAN00_6199f384, CanIfHthIdSymRef=CanConfigSet/CN_CAN00_a2373004_Tx
      4 x CanIfRxPduCfg, all with CanIfRxPduCanIdType=STANDARD_CAN, CanIfRxPduHrhIdRef=CanIfInitHohCfg/CN_CAN00_193527e3_Rx:
        BFC_665f3a14_Rx: CanIfRxPduDlc=8, CanIfRxPduUserRxIndicationName=CanNm_RxIndication, CanIfRxPduUserRxIndicationUL=CAN_NM, CanIfRxPduRef=BFC_f09b214a_Rx
          CHNL_6a942da5 (CanIfRxPduCanIdRange): CanIfRxPduCanIdRangeLowerCanId=1024, CanIfRxPduCanIdRangeUpperCanId=1087
        LightSwitch_oCAN00_042dae16_Rx: CanIfRxPduCanId=528, CanIfRxPduDlc=2, CanIfRxPduUserRxIndicationName=PduR_CanIfRxIndication, CanIfRxPduUserRxIndicationUL=PDUR, CanIfRxPduRef=EcucPduCollection/LightSwitch_oCAN00_8d4de26e_Rx
        Msg_Diag_Request_BFC_Tp_oCAN00_27733d79_Rx: CanIfRxPduCanId=1442, CanIfRxPduDlc=8, CanIfRxPduUserRxIndicationName=CanTp_RxIndication, CanIfRxPduUserRxIndicationType=PDUID_PDUINFOPTR, CanIfRxPduUserRxIndicationUL=CAN_TP, CanIfRxPduRef=Msg_Diag_Request_BFC_Tp_oCAN00_ebe478a8_Rx
        Msg_Diag_Request_Global_Tp_oCAN00_ea5f45d3_Rx: CanIfRxPduCanId=1913, CanIfRxPduDlc=8, CanIfRxPduUserRxIndicationName=CanTp_RxIndication, CanIfRxPduUserRxIndicationType=PDUID_PDUINFOPTR, CanIfRxPduUserRxIndicationUL=CAN_TP, CanIfRxPduRef=Msg_Diag_Request_Global_Tp_oCAN00_eed4c6c0_Rx
      4 x CanIfTxPduCfg, all with CanIfTxPduCanIdType=STANDARD_CAN, CanIfTxPduDlc=8, CanIfTxPduBufferRef=CanIfInitCfg/CHNL_0fb271d2:
        LightCtrl_oCAN00_d9f1a7da_Tx: CanIfTxPduCanId=616, CanIfTxPduUserTxConfirmationName=PduR_CanIfTxConfirmation, CanIfTxPduUserTxConfirmationUL=PDUR, CanIfTxPduRef=EcucPduCollection/LightCtrl_oCAN00_0afee19e_Tx
        Msg_Diag_Response_BFC_Tp_oCAN00_be6a9846_Tx: CanIfTxPduCanId=1458, CanIfTxPduUserTxConfirmationName=CanTp_TxConfirmation, CanIfTxPduUserTxConfirmationUL=CAN_TP, CanIfTxPduRef=Msg_Diag_Response_BFC_Tp_oCAN00_2e02c5db_Tx
        Msg_Diag_Uudt_Response_BFC_oCAN00_9005f57f_Tx: CanIfTxPduCanId=1558, CanIfTxPduUserTxConfirmationName=PduR_CanIfTxConfirmation, CanIfTxPduUserTxConfirmationUL=PDUR, CanIfTxPduRef=EcucPduCollection/Msg_Diag_Uudt_Response_BFC_oCAN00_b52a569b_Tx
        NmBFC_oCAN00_feb4f615_Tx: CanIfTxPduCanId=1026, CanIfTxPduUserTxConfirmationName=CanNm_TxConfirmation, CanIfTxPduUserTxConfirmationUL=CAN_NM, CanIfTxPduRef=EcucPduCollection/NmBFC_oCAN00_4874935e_Tx
    CanIfPrivateCfg: CanIfPrivateSoftwareFilterType=LINEAR
    CanIfPublicCfg: CanIfPublicPnSupport=false
  module config CanNm
    CanNmGlobalConfig: CanNmNodeIdEnabled=false, CanNmPnEiraCalcEnabled=false, CanNmUserDataEnabled=true
      CAN00_CAN_5faa4e95 (CanNmChannelConfig):
        CanNmMsgCycleOffset = 0
        CanNmMsgCycleTime = 0.1
        CanNmMsgReducedTime = 0.05
        CanNmNodeId = 2
        CanNmNodeIdEnabled = false
        CanNmPduCbvPosition = CANNM_PDU_OFF
        CanNmPduNidPosition = CANNM_PDU_OFF
        CanNmRepeatMessageTime = 0.4
        CanNmTimeoutTime = 1
        CanNmWaitBusSleepTime = 0.75
        CanNmComMNetworkHandleRef = ComMConfigSet/CN_CAN00_a2373004
        CAN00_CAN_5faa4e95_Rx (CanNmRxPdu): CanNmRxPduRef=BFC_f09b214a_Rx
        NmBFC_oCAN00_4874935e_Tx (CanNmTxPdu): CanNmTxPduRef=EcucPduCollection/NmBFC_oCAN00_4874935e_Tx
  module config CanSM
    CanSMConfiguration
      CHNL_0fb271d2 (CanSMManagerNetwork): CanSMComMNetworkHandleRef=ComMConfigSet/CN_CAN00_a2373004
        CT_CAN00_9bd332a1 (CanSMController): CanSMControllerId=CanIfCtrlDrvCfg_7d254554/CT_CAN00_6199f384
  module config CanTp
    CanTpConfig: CanTpMainFunctionPeriod=0.005
      TPCH_13a8ffe3 (CanTpChannel): CanTpChannelMode=CANTP_MODE_FULL_DUPLEX
        CanTpRxNSdu_f5b08299 (CanTpRxNSdu):
          CanTpRxAddressingFormat = CANTP_STANDARD
          CanTpRxDl = 8
          CanTpRxTaType = CANTP_FUNCTIONAL
          CanTpRxNSduRef = EcucPduCollection/Msg_Diag_Request_Global_oCAN00_4d90f286_Rx
          CanTpRxNPdu_0f0586ce (CanTpRxNPdu): CanTpRxNPduRef=Msg_Diag_Request_Global_Tp_oCAN00_eed4c6c0_Rx
      TPCH_20e8b80c (CanTpChannel): CanTpChannelMode=CANTP_MODE_FULL_DUPLEX
        CanTpRxNSdu_94a1b1f9 (CanTpRxNSdu):
          CanTpRxAddressingFormat = CANTP_STANDARD
          CanTpRxDl = 8
          CanTpRxTaType = CANTP_PHYSICAL
          CanTpRxNSduRef = EcucPduCollection/Msg_Diag_Request_BFC_oCAN00_7ad4193d_Rx
          CanTpRxNPdu_ffd63c24 (CanTpRxNPdu): CanTpRxNPduRef=Msg_Diag_Request_BFC_Tp_oCAN00_ebe478a8_Rx
          CanTpTxFcNPdu_ffd63c24 (CanTpTxFcNPdu): CanTpTxFcNPduRef=Msg_Diag_Response_BFC_Tp_oCAN00_2e02c5db_Tx
        CanTpTxNSdu_94a1b1f9 (CanTpTxNSdu):
          CanTpTxAddressingFormat = CANTP_STANDARD
          CanTpTxDl = 8
          CanTpTxTaType = CANTP_PHYSICAL
          CanTpTxNSduRef = EcucPduCollection/Msg_Diag_Response_BFC_oCAN00_68c05815_Tx
          CanTpRxFcNPdu_dd2ce8d6 (CanTpRxFcNPdu): CanTpRxFcNPduRef=Msg_Diag_Request_BFC_Tp_oCAN00_ebe478a8_Rx
          CanTpTxNPdu_dd2ce8d6 (CanTpTxNPdu): CanTpTxNPduRef=Msg_Diag_Response_BFC_Tp_oCAN00_2e02c5db_Tx
  module config Com
    ComConfig
      LightCtrl_oCAN00_2e88b3f5_Tx (ComIPdu):
        ComIPduDirection = SEND
        ComIPduType = NORMAL
        ComIPduGroupRef = BFC_oCAN00_Tx_5d56b2ca
        ComIPduSignalRef = HeadLight_oLightCtrl_oCAN00_3d3756da_Tx
        ComPduIdRef = EcucPduCollection/LightCtrl_oCAN00_2e88b3f5_Tx
        ComTxIPdu: ComMinimumDelayTime=0, ComTxIPduUnusedAreasDefault=0
          ComTxModeFalse
            ComTxMode: ComTxModeMode=PERIODIC, ComTxModeTimeOffset=0, ComTxModeTimePeriod=0.01
          ComTxModeTrue
            ComTxMode: ComTxModeMode=PERIODIC, ComTxModeTimeOffset=0, ComTxModeTimePeriod=0.01
      LightSwitch_oCAN00_d3b6d56e_Rx (ComIPdu):
        ComIPduDirection = RECEIVE
        ComIPduType = NORMAL
        ComIPduGroupRef = BFC_oCAN00_Rx_0b0c154c
        ComIPduSignalRef = LightSwitch_oLightSwitch_oCAN00_b775c021_Rx
        ComPduIdRef = EcucPduCollection/LightSwitch_oCAN00_d3b6d56e_Rx
      BFC_oCAN00_Rx_0b0c154c (ComIPduGroup)
      BFC_oCAN00_Tx_5d56b2ca (ComIPduGroup)
      HeadLight_oLightCtrl_oCAN00_3d3756da_Tx (ComSignal):
        ComBitPosition = 0
        ComBitSize = 1
        ComSignalEndianness = LITTLE_ENDIAN
        ComSignalInitValue = 0
        ComSignalType = BOOLEAN
        ComTransferProperty = PENDING
        ComSystemTemplateSystemSignalRef = HeadLight
      LightSwitch_oLightSwitch_oCAN00_b775c021_Rx (ComSignal):
        ComBitPosition = 0
        ComBitSize = 2
        ComSignalDataInvalidValue = 3
        ComSignalEndianness = LITTLE_ENDIAN
        ComSignalInitValue = 0
        ComSignalType = UINT8
        ComTimeout = 0
        ComSystemTemplateSystemSignalRef = LightSwitch
    ComGeneral
  module config ComM
    ComMConfigSet: ComMPncEnabled=false
      CN_CAN00_a2373004 (ComMChannel): ComMBusType=COMM_BUS_TYPE_CAN, ComMChannelId=0
        ComMNetworkManagement: ComMNmVariant=FULL
        CN_CAN00_6854f362 (ComMUserPerChannel): ComMUserChannel=CN_CAN00_68d36c54
      CN_CAN00_68d36c54 (ComMUser)
    ComMGeneral: ComMPncIdCounting=COMM_PNC_ID_COUNT_FROM_NM_MESSAGE, ComMPncSupport=false
  module config Dcm
    DcmConfigSet  # Diagnostics Data Import
      DcmDsl
        DcmDslProtocol
          DcmDslProtocolRow_29812fbf (DcmDslProtocolRow)
            DC_0xE001_oBFC_oCAN00_334a4252 (DcmDslConnection)
              DC_0xE001_oBFC_oCAN00_334a4252 (DcmDslMainConnection): DcmDslProtocolRxTesterSourceAddr=224
                Msg_Diag_Request_BFC_oCAN00_dced82e4_Rx_c6c952d2 (DcmDslProtocolRx):
                  DcmDslProtocolRxAddrType = DCM_PHYSICAL_TYPE
                  DcmDslProtocolRxPduId = 1
                  DcmDslProtocolRxComMChannelRef = ComMConfigSet/CN_CAN00_a2373004
                  DcmDslProtocolRxPduRef = Msg_Diag_Request_BFC_oCAN00_dced82e4_Rx
                Msg_Diag_Request_Global_oCAN00_85e930b7_Rx_52caa196 (DcmDslProtocolRx):
                  DcmDslProtocolRxAddrType = DCM_FUNCTIONAL_TYPE
                  DcmDslProtocolRxPduId = 2
                  DcmDslProtocolRxComMChannelRef = ComMConfigSet/CN_CAN00_a2373004
                  DcmDslProtocolRxPduRef = Msg_Diag_Request_Global_oCAN00_85e930b7_Rx
                Msg_Diag_Response_BFC_oCAN00_61e49ee1_Tx_a9914860 (DcmDslProtocolTx): DcmDslTxConfirmationPduId=0, DcmDslProtocolTxPduRef=EcucPduCollection/Msg_Diag_Response_BFC_oCAN00_61e49ee1_Tx
      DcmDsp: DcmDspMaxDidToRead=5  # Diagnostics Data Import
        ComControl (DcmDspComControl)  # Diagnostics Data Import
          DspComContolAllChannel (DcmDspComControlAllChannel)  # Diagnostics Data Import
        DcmDspSession  # Diagnostics Data Import
          3 x DcmDspSessionRow, all with DcmDspSessionP2ServerMax=0.05, DcmDspSessionP2StarServerMax=5:
            Extended: DcmDspSessionLevel=3, DcmDspSessionForBoot=DCM_NO_BOOT  # Diagnostics Data Import
            Programming: DcmDspSessionLevel=2  # Diagnostics Data Import
            Default: DcmDspSessionLevel=1, DcmDspSessionForBoot=DCM_NO_BOOT  # Diagnostics Data Import
        DcmDspSecurity  # Diagnostics Data Import
          Level_3 (DcmDspSecurityRow):  # Diagnostics Data Import
            DcmDspSecurityDelayTime = 10
            DcmDspSecurityDelayTimeOnBoot = 0
            DcmDspSecurityKeySize = 2
            DcmDspSecurityLevel = 2
            DcmDspSecurityNumAttDelay = 3
            DcmDspSecuritySeedSize = 2
          UnlockedL1 (DcmDspSecurityRow):  # Diagnostics Data Import
            DcmDspSecurityDelayTime = 10
            DcmDspSecurityDelayTimeOnBoot = 0
            DcmDspSecurityKeySize = 4
            DcmDspSecurityLevel = 1
            DcmDspSecurityNumAttDelay = 3
            DcmDspSecuritySeedSize = 4
        RoutineInfo_SampleRoutineControl_StartOnly (DcmDspRoutineInfo)  # Diagnostics Data Import
          DcmDspRoutineRequestResOut  # Diagnostics Data Import
            Out_Result (DcmDspRoutineRequestResOutSignal): DcmDspRoutineSignalLength=32, DcmDspRoutineSignalType=UINT32, DcmDspRoutineSignalEndianness=BIG_ENDIAN, DcmDspRoutineSignalPos=0  # Diagnostics Data Import
          DcmDspStartRoutineIn  # Diagnostics Data Import
            In_Option1 (DcmDspStartRoutineInSignal): DcmDspRoutineSignalLength=24, DcmDspRoutineSignalType=UINT8_N, DcmDspRoutineSignalEndianness=opaque, DcmDspRoutineSignalPos=0  # Diagnostics Data Import
          DcmDspRoutineAuthorization: DcmDspRoutineSessionRef=DcmDspSession/Programming, DcmDspRoutineSessionRef=DcmDspSession/Extended  # Diagnostics Data Import
        RoutineInfo_SampleRoutineControl (DcmDspRoutineInfo)  # Diagnostics Data Import
          DcmDspRoutineRequestResOut  # Diagnostics Data Import
            Out_Result (DcmDspRoutineRequestResOutSignal): DcmDspRoutineSignalLength=16, DcmDspRoutineSignalType=UINT16, DcmDspRoutineSignalEndianness=BIG_ENDIAN, DcmDspRoutineSignalPos=0  # Diagnostics Data Import
          DcmDspRoutineStopOut  # Diagnostics Data Import
            Out_StopState (DcmDspRoutineStopOutSignal): DcmDspRoutineSignalLength=32, DcmDspRoutineSignalType=UINT32, DcmDspRoutineSignalEndianness=BIG_ENDIAN, DcmDspRoutineSignalPos=0  # Diagnostics Data Import
          DcmDspStartRoutineOut  # Diagnostics Data Import
            Out_InitState (DcmDspStartRoutineOutSignal): DcmDspRoutineSignalLength=32, DcmDspRoutineSignalType=UINT32, DcmDspRoutineSignalEndianness=BIG_ENDIAN, DcmDspRoutineSignalPos=0  # Diagnostics Data Import
          DcmDspStartRoutineIn  # Diagnostics Data Import
            In_Option0 (DcmDspStartRoutineInSignal): DcmDspRoutineSignalLength=8, DcmDspRoutineSignalType=UINT8, DcmDspRoutineSignalPos=0  # Diagnostics Data Import
          DcmDspRoutineAuthorization: DcmDspRoutineSessionRef=DcmDspSession/Programming, DcmDspRoutineSessionRef=DcmDspSession/Extended  # Diagnostics Data Import
        SampleRoutineControl_StartOnly (DcmDspRoutine):  # Diagnostics Data Import
          DcmDspRequestResultsRoutineSupported = true
          DcmDspStopRoutineSupported = false
          DcmDspRoutineIdentifier = 260
          DcmDspRoutineInfoRef = RoutineInfo_SampleRoutineControl_StartOnly
        SampleRoutineControl (DcmDspRoutine):  # Diagnostics Data Import
          DcmDspRequestResultsRoutineSupported = true
          DcmDspStopRoutineSupported = true
          DcmDspRoutineIdentifier = 256
          DcmDspRoutineInfoRef = RoutineInfo_SampleRoutineControl
        20 x DcmDspDidInfo:
          DidInfo_DID_0xF413  # Diagnostics Data Import
            DcmDspDidAccess  # Diagnostics Data Import
              DcmDspDidRead  # Diagnostics Data Import
          DidInfo_DID_0xF412  # Diagnostics Data Import
            DcmDspDidAccess  # Diagnostics Data Import
              DcmDspDidRead  # Diagnostics Data Import
          DidInfo_DID_0xF410  # Diagnostics Data Import
            DcmDspDidAccess  # Diagnostics Data Import
              DcmDspDidRead  # Diagnostics Data Import
          DidInfo_Hardware_Version  # Diagnostics Data Import
            DcmDspDidAccess  # Diagnostics Data Import
              DcmDspDidWrite  # Diagnostics Data Import
              DcmDspDidRead  # Diagnostics Data Import
          DidInfo_Vehicle_Identification  # Diagnostics Data Import
            DcmDspDidAccess  # Diagnostics Data Import
              DcmDspDidWrite  # Diagnostics Data Import
              DcmDspDidRead  # Diagnostics Data Import
          DidInfo_SerialNumber  # Diagnostics Data Import
            DcmDspDidAccess  # Diagnostics Data Import
              DcmDspDidWrite  # Diagnostics Data Import
              DcmDspDidRead  # Diagnostics Data Import
          DidInfo_EcuIdentification  # Diagnostics Data Import
            DcmDspDidAccess  # Diagnostics Data Import
              DcmDspDidWrite  # Diagnostics Data Import
              DcmDspDidRead  # Diagnostics Data Import
          DidInfo_Spare_Part_Number  # Diagnostics Data Import
            DcmDspDidAccess  # Diagnostics Data Import
              DcmDspDidWrite  # Diagnostics Data Import
              DcmDspDidRead  # Diagnostics Data Import
          DidInfo_Boot_Software  # Diagnostics Data Import
            DcmDspDidAccess  # Diagnostics Data Import
              DcmDspDidWrite  # Diagnostics Data Import
              DcmDspDidRead  # Diagnostics Data Import
          DidInfo_DataDiagnosticIdentifier_DID  # Diagnostics Data Import
            DcmDspDidAccess  # Diagnostics Data Import
              DcmDspDidWrite  # Diagnostics Data Import
              DcmDspDidRead  # Diagnostics Data Import
          DidInfo_DevelopmentData  # Diagnostics Data Import
            DcmDspDidAccess  # Diagnostics Data Import
              DcmDspDidWrite  # Diagnostics Data Import
              DcmDspDidRead  # Diagnostics Data Import
          DidInfo_DID_0x001B  # Diagnostics Data Import
            DcmDspDidAccess  # Diagnostics Data Import
              DcmDspDidWrite  # Diagnostics Data Import
          DidInfo_DID_0x001A  # Diagnostics Data Import
            DcmDspDidAccess  # Diagnostics Data Import
              DcmDspDidWrite  # Diagnostics Data Import
              DcmDspDidRead  # Diagnostics Data Import
          DidInfo_DID_0x0019  # Diagnostics Data Import
            DcmDspDidAccess  # Diagnostics Data Import
              DcmDspDidRead  # Diagnostics Data Import
          DidInfo_DID_0x0018  # Diagnostics Data Import
            DcmDspDidAccess  # Diagnostics Data Import
              DcmDspDidWrite  # Diagnostics Data Import
              DcmDspDidRead  # Diagnostics Data Import
          DidInfo_DID_0x0017  # Diagnostics Data Import
            DcmDspDidAccess  # Diagnostics Data Import
              DcmDspDidWrite  # Diagnostics Data Import
          DidInfo_Example_WriteOnlyDID  # Diagnostics Data Import
            DcmDspDidAccess  # Diagnostics Data Import
              DcmDspDidWrite  # Diagnostics Data Import
          DidInfo_SampleIoControl  # Diagnostics Data Import
            DcmDspDidAccess  # Diagnostics Data Import
              DcmDspDidRead  # Diagnostics Data Import
              DcmDspDidControl:  # Diagnostics Data Import
                DcmDspDidFreezeCurrentState = true
                DcmDspDidResetToDefault = true
                DcmDspDidReturnControlToEcu = true
                DcmDspDidShortTermAdjustment = true
                DcmDspDidControlSessionRef = DcmDspSession/Extended
          DidInfo_Example_ReadWriteData  # Diagnostics Data Import
            DcmDspDidAccess  # Diagnostics Data Import
              DcmDspDidWrite  # Diagnostics Data Import
              DcmDspDidRead  # Diagnostics Data Import
          DidInfo_Example_ReadOnlyDID  # Diagnostics Data Import
            DcmDspDidAccess  # Diagnostics Data Import
              DcmDspDidRead  # Diagnostics Data Import
        20 x DcmDspDid:
          DID_0xF413: DcmDspDidIdentifier=62483, DcmDspDidInfoRef=DidInfo_DID_0xF413  # Diagnostics Data Import
            DID_Data (DcmDspDidSignal): DcmDspDidDataPos=0, DcmDspDidDataRef=DID_0xF413_DID_Data  # Diagnostics Data Import
          DID_0xF412: DcmDspDidIdentifier=62482, DcmDspDidInfoRef=DidInfo_DID_0xF412  # Diagnostics Data Import
            DID_Data (DcmDspDidSignal): DcmDspDidDataPos=0, DcmDspDidDataRef=DID_0xF412_DID_Data  # Diagnostics Data Import
          DID_0xF410: DcmDspDidIdentifier=62480, DcmDspDidInfoRef=DidInfo_DID_0xF410  # Diagnostics Data Import
            DID_Data (DcmDspDidSignal): DcmDspDidDataPos=0, DcmDspDidDataRef=DID_0xF410_DID_Data  # Diagnostics Data Import
          Hardware_Version: DcmDspDidIdentifier=61843, DcmDspDidInfoRef=DidInfo_Hardware_Version  # Diagnostics Data Import
            Hardware_Version_Number (DcmDspDidSignal): DcmDspDidDataPos=0, DcmDspDidDataRef=Hardware_Version_Hardware_Version_Number  # Diagnostics Data Import
          Vehicle_Identification: DcmDspDidIdentifier=61840, DcmDspDidInfoRef=DidInfo_Vehicle_Identification  # Diagnostics Data Import
            VIN (DcmDspDidSignal): DcmDspDidDataPos=0, DcmDspDidDataRef=Vehicle_Identification_VIN  # Diagnostics Data Import
          SerialNumber: DcmDspDidIdentifier=61836, DcmDspDidInfoRef=DidInfo_SerialNumber  # Diagnostics Data Import
            SerialNumber (DcmDspDidSignal): DcmDspDidDataPos=0, DcmDspDidDataRef=SerialNumber_SerialNumber  # Diagnostics Data Import
          EcuIdentification: DcmDspDidIdentifier=61833, DcmDspDidInfoRef=DidInfo_EcuIdentification  # Diagnostics Data Import
            Part_Number (DcmDspDidSignal): DcmDspDidDataPos=0, DcmDspDidDataRef=EcuIdentification_Part_Number  # Diagnostics Data Import
          Spare_Part_Number: DcmDspDidIdentifier=61831, DcmDspDidInfoRef=DidInfo_Spare_Part_Number  # Diagnostics Data Import
            Spare_Part_Number (DcmDspDidSignal): DcmDspDidDataPos=0, DcmDspDidDataRef=Spare_Part_Number_Spare_Part_Number  # Diagnostics Data Import
          Boot_Software: DcmDspDidIdentifier=61824, DcmDspDidInfoRef=DidInfo_Boot_Software  # Diagnostics Data Import
            Boot_Software_Identification (DcmDspDidSignal): DcmDspDidDataPos=8, DcmDspDidDataRef=Boot_Software_Boot_Software_Identification  # Diagnostics Data Import
            NumberOfModules (DcmDspDidSignal): DcmDspDidDataPos=0, DcmDspDidDataRef=Boot_Software_NumberOfModules  # Diagnostics Data Import
          DataDiagnosticIdentifier_DID: DcmDspDidIdentifier=257, DcmDspDidInfoRef=DidInfo_DataDiagnosticIdentifier_DID  # Diagnostics Data Import
            DataDiagnosticIdentifier (DcmDspDidSignal): DcmDspDidDataPos=0, DcmDspDidDataRef=DataDiagnosticIdentifier_DID_DataDiagnosticIdentifier  # Diagnostics Data Import
          DevelopmentData: DcmDspDidIdentifier=256, DcmDspDidInfoRef=DidInfo_DevelopmentData  # Diagnostics Data Import
            5 x DcmDspDidSignal:
              TransportLayerVersion: DcmDspDidDataPos=64, DcmDspDidDataRef=DevelopmentData_TransportLayerVersion  # Diagnostics Data Import
              DiagnosticModuleVersion: DcmDspDidDataPos=48, DcmDspDidDataRef=DevelopmentData_DiagnosticModuleVersion  # Diagnostics Data Import
              NmVersion: DcmDspDidDataPos=32, DcmDspDidDataRef=DevelopmentData_NmVersion  # Diagnostics Data Import
              CanDriverVersion: DcmDspDidDataPos=16, DcmDspDidDataRef=DevelopmentData_CanDriverVersion  # Diagnostics Data Import
              OperatingSystemVersion: DcmDspDidDataPos=0, DcmDspDidDataRef=DevelopmentData_OperatingSystemVersion  # Diagnostics Data Import
          DID_0x001B: DcmDspDidIdentifier=27, DcmDspDidInfoRef=DidInfo_DID_0x001B  # Diagnostics Data Import
            DID_Sint8_Array (DcmDspDidSignal): DcmDspDidDataPos=0, DcmDspDidDataRef=DID_0x001B_DID_Sint8_Array  # Diagnostics Data Import
          DID_0x001A: DcmDspDidIdentifier=26, DcmDspDidInfoRef=DidInfo_DID_0x001A  # Diagnostics Data Import
            DID_Uint16_Array (DcmDspDidSignal): DcmDspDidDataPos=0, DcmDspDidDataRef=DID_0x001A_DID_Uint16_Array  # Diagnostics Data Import
          DID_0x0019: DcmDspDidIdentifier=25, DcmDspDidInfoRef=DidInfo_DID_0x0019  # Diagnostics Data Import
            DID_Sint16_Array (DcmDspDidSignal): DcmDspDidDataPos=0, DcmDspDidDataRef=DID_0x0019_DID_Sint16_Array  # Diagnostics Data Import
          DID_0x0018: DcmDspDidIdentifier=24, DcmDspDidInfoRef=DidInfo_DID_0x0018  # Diagnostics Data Import
            DID_Uint32_Array (DcmDspDidSignal): DcmDspDidDataPos=0, DcmDspDidDataRef=DID_0x0018_DID_Uint32_Array  # Diagnostics Data Import
          DID_0x0017: DcmDspDidIdentifier=23, DcmDspDidInfoRef=DidInfo_DID_0x0017  # Diagnostics Data Import
            DID_Sint32_Array (DcmDspDidSignal): DcmDspDidDataPos=0, DcmDspDidDataRef=DID_0x0017_DID_Sint32_Array  # Diagnostics Data Import
          Example_WriteOnlyDID: DcmDspDidIdentifier=4, DcmDspDidInfoRef=DidInfo_Example_WriteOnlyDID  # Diagnostics Data Import
            DID_DataObject (DcmDspDidSignal): DcmDspDidDataPos=0, DcmDspDidDataRef=Example_WriteOnlyDID_DID_DataObject  # Diagnostics Data Import
          SampleIoControl: DcmDspDidIdentifier=3, DcmDspDidInfoRef=DidInfo_SampleIoControl  # Diagnostics Data Import
            DID_Data (DcmDspDidSignal): DcmDspDidDataPos=0, DcmDspDidDataRef=SampleIoControl_DID_Data  # Diagnostics Data Import
          Example_ReadWriteData: DcmDspDidIdentifier=2, DcmDspDidInfoRef=DidInfo_Example_ReadWriteData  # Diagnostics Data Import
            GlobalTime (DcmDspDidSignal): DcmDspDidDataPos=0, DcmDspDidDataRef=Example_ReadWriteData_GlobalTime  # Diagnostics Data Import
          Example_ReadOnlyDID: DcmDspDidIdentifier=1, DcmDspDidInfoRef=DidInfo_Example_ReadOnlyDID  # Diagnostics Data Import
            DID_Data_GlobalTime (DcmDspDidSignal): DcmDspDidDataPos=0, DcmDspDidDataRef=Example_ReadOnlyDID_DID_Data_GlobalTime  # Diagnostics Data Import
        DataInfo_DID_0xF413_DID_Data (DcmDspDataInfo): DcmDspDataFixedLength=true  # Diagnostics Data Import
        DID_0xF413_DID_Data (DcmDspData): DcmDspDataSize=16, DcmDspDataType=UINT16, DcmDspDataInfoRef=DataInfo_DID_0xF413_DID_Data  # Diagnostics Data Import
        DataInfo_DID_0xF412_DID_Data (DcmDspDataInfo): DcmDspDataFixedLength=true  # Diagnostics Data Import
        DID_0xF412_DID_Data (DcmDspData): DcmDspDataSize=16, DcmDspDataType=UINT16, DcmDspDataInfoRef=DataInfo_DID_0xF412_DID_Data  # Diagnostics Data Import
        DataInfo_DID_0xF410_DID_Data (DcmDspDataInfo): DcmDspDataFixedLength=true  # Diagnostics Data Import
        DID_0xF410_DID_Data (DcmDspData): DcmDspDataSize=16, DcmDspDataType=UINT16, DcmDspDataInfoRef=DataInfo_DID_0xF410_DID_Data  # Diagnostics Data Import
        DataInfo_Hardware_Version_Hardware_Version_Number (DcmDspDataInfo): DcmDspDataFixedLength=true  # Diagnostics Data Import
        Hardware_Version_Hardware_Version_Number (DcmDspData): DcmDspDataSize=120, DcmDspDataType=UINT8_N, DcmDspDataInfoRef=DataInfo_Hardware_Version_Hardware_Version_Number  # Diagnostics Data Import
        DataInfo_Vehicle_Identification_VIN (DcmDspDataInfo): DcmDspDataFixedLength=true  # Diagnostics Data Import
        Vehicle_Identification_VIN (DcmDspData): DcmDspDataSize=136, DcmDspDataType=UINT8_N, DcmDspDataInfoRef=DataInfo_Vehicle_Identification_VIN  # Diagnostics Data Import
        DataInfo_SerialNumber_SerialNumber (DcmDspDataInfo): DcmDspDataFixedLength=true  # Diagnostics Data Import
        SerialNumber_SerialNumber (DcmDspData): DcmDspDataSize=32, DcmDspDataType=UINT32, DcmDspDataInfoRef=DataInfo_SerialNumber_SerialNumber  # Diagnostics Data Import
        DataInfo_EcuIdentification_Part_Number (DcmDspDataInfo): DcmDspDataFixedLength=true  # Diagnostics Data Import
        EcuIdentification_Part_Number (DcmDspData): DcmDspDataSize=104, DcmDspDataType=UINT8_N, DcmDspDataInfoRef=DataInfo_EcuIdentification_Part_Number  # Diagnostics Data Import
        DataInfo_Spare_Part_Number_Spare_Part_Number (DcmDspDataInfo): DcmDspDataFixedLength=true  # Diagnostics Data Import
        Spare_Part_Number_Spare_Part_Number (DcmDspData): DcmDspDataSize=104, DcmDspDataType=UINT8_N, DcmDspDataInfoRef=DataInfo_Spare_Part_Number_Spare_Part_Number  # Diagnostics Data Import
        DataInfo_Boot_Software_Boot_Software_Identification (DcmDspDataInfo): DcmDspDataFixedLength=true  # Diagnostics Data Import
        Boot_Software_Boot_Software_Identification (DcmDspData): DcmDspDataSize=32, DcmDspDataType=UINT32, DcmDspDataInfoRef=DataInfo_Boot_Software_Boot_Software_Identification  # Diagnostics Data Import
        DataInfo_Boot_Software_NumberOfModules (DcmDspDataInfo): DcmDspDataFixedLength=true  # Diagnostics Data Import
        Boot_Software_NumberOfModules (DcmDspData): DcmDspDataSize=8, DcmDspDataType=UINT8, DcmDspDataInfoRef=DataInfo_Boot_Software_NumberOfModules  # Diagnostics Data Import
        DataInfo_DataDiagnosticIdentifier_DID_DataDiagnosticIdentifier (DcmDspDataInfo): DcmDspDataFixedLength=true  # Diagnostics Data Import
        DataDiagnosticIdentifier_DID_DataDiagnosticIdentifier (DcmDspData): DcmDspDataSize=16, DcmDspDataType=UINT16, DcmDspDataInfoRef=DataInfo_DataDiagnosticIdentifier_DID_DataDiagnosticIdentifier  # Diagnostics Data Import
        DataInfo_DevelopmentData_TransportLayerVersion (DcmDspDataInfo): DcmDspDataFixedLength=true  # Diagnostics Data Import
        DevelopmentData_TransportLayerVersion (DcmDspData): DcmDspDataSize=16, DcmDspDataType=UINT16, DcmDspDataInfoRef=DataInfo_DevelopmentData_TransportLayerVersion  # Diagnostics Data Import
        DataInfo_DevelopmentData_DiagnosticModuleVersion (DcmDspDataInfo): DcmDspDataFixedLength=true  # Diagnostics Data Import
        DevelopmentData_DiagnosticModuleVersion (DcmDspData): DcmDspDataSize=16, DcmDspDataType=UINT16, DcmDspDataInfoRef=DataInfo_DevelopmentData_DiagnosticModuleVersion  # Diagnostics Data Import
        DataInfo_DevelopmentData_NmVersion (DcmDspDataInfo): DcmDspDataFixedLength=true  # Diagnostics Data Import
        DevelopmentData_NmVersion (DcmDspData): DcmDspDataSize=16, DcmDspDataType=UINT16, DcmDspDataInfoRef=DataInfo_DevelopmentData_NmVersion  # Diagnostics Data Import
        DataInfo_DevelopmentData_CanDriverVersion (DcmDspDataInfo): DcmDspDataFixedLength=true  # Diagnostics Data Import
        DevelopmentData_CanDriverVersion (DcmDspData): DcmDspDataSize=16, DcmDspDataType=UINT16, DcmDspDataInfoRef=DataInfo_DevelopmentData_CanDriverVersion  # Diagnostics Data Import
        DataInfo_DevelopmentData_OperatingSystemVersion (DcmDspDataInfo): DcmDspDataFixedLength=true  # Diagnostics Data Import
        DevelopmentData_OperatingSystemVersion (DcmDspData): DcmDspDataSize=16, DcmDspDataType=UINT16, DcmDspDataInfoRef=DataInfo_DevelopmentData_OperatingSystemVersion  # Diagnostics Data Import
        DataInfo_DID_0x001B_DID_Sint8_Array (DcmDspDataInfo): DcmDspDataFixedLength=true  # Diagnostics Data Import
        DID_0x001B_DID_Sint8_Array (DcmDspData): DcmDspDataSize=224, DcmDspDataType=SINT8_N, DcmDspDataInfoRef=DataInfo_DID_0x001B_DID_Sint8_Array  # Diagnostics Data Import
        DataInfo_DID_0x001A_DID_Uint16_Array (DcmDspDataInfo): DcmDspDataFixedLength=true  # Diagnostics Data Import
        DID_0x001A_DID_Uint16_Array (DcmDspData): DcmDspDataSize=64, DcmDspDataType=UINT16_N, DcmDspDataInfoRef=DataInfo_DID_0x001A_DID_Uint16_Array  # Diagnostics Data Import
        DataInfo_DID_0x0019_DID_Sint16_Array (DcmDspDataInfo): DcmDspDataFixedLength=true  # Diagnostics Data Import
        DID_0x0019_DID_Sint16_Array (DcmDspData): DcmDspDataSize=176, DcmDspDataType=SINT16_N, DcmDspDataInfoRef=DataInfo_DID_0x0019_DID_Sint16_Array  # Diagnostics Data Import
        DataInfo_DID_0x0018_DID_Uint32_Array (DcmDspDataInfo): DcmDspDataFixedLength=true  # Diagnostics Data Import
        DID_0x0018_DID_Uint32_Array (DcmDspData): DcmDspDataSize=192, DcmDspDataType=UINT32_N, DcmDspDataInfoRef=DataInfo_DID_0x0018_DID_Uint32_Array  # Diagnostics Data Import
        DataInfo_DID_0x0017_DID_Sint32_Array (DcmDspDataInfo): DcmDspDataFixedLength=true  # Diagnostics Data Import
        DID_0x0017_DID_Sint32_Array (DcmDspData): DcmDspDataSize=160, DcmDspDataType=SINT32_N, DcmDspDataInfoRef=DataInfo_DID_0x0017_DID_Sint32_Array  # Diagnostics Data Import
        DataInfo_Example_WriteOnlyDID_DID_DataObject (DcmDspDataInfo): DcmDspDataFixedLength=true  # Diagnostics Data Import
        Example_WriteOnlyDID_DID_DataObject (DcmDspData): DcmDspDataSize=8, DcmDspDataType=UINT8, DcmDspDataInfoRef=DataInfo_Example_WriteOnlyDID_DID_DataObject  # Diagnostics Data Import
        DataInfo_SampleIoControl_DID_Data (DcmDspDataInfo): DcmDspDataFixedLength=true  # Diagnostics Data Import
        SampleIoControl_DID_Data (DcmDspData): DcmDspDataConditionCheckReadFncUsed=false, DcmDspDataSize=32, DcmDspDataType=UINT32, DcmDspDataInfoRef=DataInfo_SampleIoControl_DID_Data  # Diagnostics Data Import
        DataInfo_Example_ReadWriteData_GlobalTime (DcmDspDataInfo): DcmDspDataFixedLength=true  # Diagnostics Data Import
        Example_ReadWriteData_GlobalTime (DcmDspData): DcmDspDataSize=32, DcmDspDataType=UINT32, DcmDspDataInfoRef=DataInfo_Example_ReadWriteData_GlobalTime  # Diagnostics Data Import
        DataInfo_Example_ReadOnlyDID_DID_Data_GlobalTime (DcmDspDataInfo): DcmDspDataFixedLength=true  # Diagnostics Data Import
        Example_ReadOnlyDID_DID_Data_GlobalTime (DcmDspData): DcmDspDataSize=48, DcmDspDataType=UINT8_N, DcmDspDataInfoRef=DataInfo_Example_ReadOnlyDID_DID_Data_GlobalTime  # Diagnostics Data Import
      DcmDsd  # Diagnostics Data Import
        DcmDsdServiceTable  # Diagnostics Data Import
          15 x DcmDsdService:
            ControlDtcSetting: DcmDsdSidTabServiceId=133, DcmDsdSidTabSubfuncAvail=true  # Diagnostics Data Import
              Disable (DcmDsdSubService): DcmDsdSubServiceId=2  # Diagnostics Data Import
              Enable (DcmDsdSubService): DcmDsdSubServiceId=1  # Diagnostics Data Import
            TesterPresent: DcmDsdSidTabServiceId=62, DcmDsdSidTabSubfuncAvail=true  # Diagnostics Data Import
              TesterPresent (DcmDsdSubService): DcmDsdSubServiceId=0  # Diagnostics Data Import
            RequestTransferExit: DcmDsdSidTabServiceId=55, DcmDsdSidTabSubfuncAvail=false, DcmDsdSidTabSessionLevelRef=DcmDspSession/Programming, DcmDsdSidTabSessionLevelRef=DcmDspSession/Extended  # Diagnostics Data Import
            TransferData: DcmDsdSidTabServiceId=54, DcmDsdSidTabSubfuncAvail=false, DcmDsdSidTabSessionLevelRef=DcmDspSession/Programming, DcmDsdSidTabSessionLevelRef=DcmDspSession/Extended  # Diagnostics Data Import
            RequestDownload: DcmDsdSidTabServiceId=52, DcmDsdSidTabSubfuncAvail=false, DcmDsdSidTabSessionLevelRef=DcmDspSession/Programming, DcmDsdSidTabSessionLevelRef=DcmDspSession/Extended  # Diagnostics Data Import
            RoutineControl: DcmDsdSidTabServiceId=49, DcmDsdSidTabSubfuncAvail=true, DcmDsdSidTabSessionLevelRef=DcmDspSession/Programming, DcmDsdSidTabSessionLevelRef=DcmDspSession/Extended  # Diagnostics Data Import
            IoControlById: DcmDsdSidTabServiceId=47, DcmDsdSidTabSubfuncAvail=false, DcmDsdSidTabSessionLevelRef=DcmDspSession/Extended  # Diagnostics Data Import
            WriteDataById: DcmDsdSidTabServiceId=46, DcmDsdSidTabSubfuncAvail=false  # Diagnostics Data Import
            CommunicationControl: DcmDsdSidTabServiceId=40, DcmDsdSidTabSubfuncAvail=true, DcmDsdSidTabSessionLevelRef=DcmDspSession/Programming, DcmDsdSidTabSessionLevelRef=DcmDspSession/Extended  # Diagnostics Data Import
              4 x DcmDsdSubService, all with DcmDsdSubServiceSessionLevelRef=DcmDspSession/Programming, DcmDsdSubServiceSessionLevelRef=DcmDspSession/Extended:
                DisableRxAndTx: DcmDsdSubServiceId=3  # Diagnostics Data Import
                DisableRxAndEnableTx: DcmDsdSubServiceId=2  # Diagnostics Data Import
                EnableRxAndDisableTx: DcmDsdSubServiceId=1  # Diagnostics Data Import
                EnableRxAndTx: DcmDsdSubServiceId=0  # Diagnostics Data Import
            SecurityAccess: DcmDsdSidTabServiceId=39, DcmDsdSidTabSubfuncAvail=true, DcmDsdSidTabSessionLevelRef=DcmDspSession/Programming, DcmDsdSidTabSessionLevelRef=DcmDspSession/Extended  # Diagnostics Data Import
              4 x DcmDsdSubService, all with DcmDsdSubServiceSessionLevelRef=DcmDspSession/Programming, DcmDsdSubServiceSessionLevelRef=DcmDspSession/Extended:
                sendKey_Send: DcmDsdSubServiceId=4  # Diagnostics Data Import
                requestSeed_Request: DcmDsdSubServiceId=3  # Diagnostics Data Import
                KeyLevel1_Send: DcmDsdSubServiceId=2  # Diagnostics Data Import
                SeedLevel1_Request: DcmDsdSubServiceId=1  # Diagnostics Data Import
            ReadDataById: DcmDsdSidTabServiceId=34, DcmDsdSidTabSubfuncAvail=false  # Diagnostics Data Import
            ReadDtcInfo: DcmDsdSidTabServiceId=25, DcmDsdSidTabSubfuncAvail=true  # Diagnostics Data Import
              12 x DcmDsdSubService:
                RDTCFDC: DcmDsdSubServiceId=20  # Diagnostics Data Import
                RMRTFDTC: DcmDsdSubServiceId=13  # Diagnostics Data Import
                RFCDTC: DcmDsdSubServiceId=12  # Diagnostics Data Import
                RSUPDTC: DcmDsdSubServiceId=10  # Diagnostics Data Import
                RSIODTC: DcmDsdSubServiceId=9  # Diagnostics Data Import
                RDTCBSMR: DcmDsdSubServiceId=8  # Diagnostics Data Import
                RNODTCBSMR: DcmDsdSubServiceId=7  # Diagnostics Data Import
                RDTCEDRBDN: DcmDsdSubServiceId=6  # Diagnostics Data Import
                RDTCSSBDTC: DcmDsdSubServiceId=4  # Diagnostics Data Import
                RDTCSSI: DcmDsdSubServiceId=3  # Diagnostics Data Import
                RDTCBSM: DcmDsdSubServiceId=2  # Diagnostics Data Import
                RNODTCBSM: DcmDsdSubServiceId=1  # Diagnostics Data Import
            ClearDiagInfo: DcmDsdSidTabServiceId=20, DcmDsdSidTabSubfuncAvail=false  # Diagnostics Data Import
            EcuReset: DcmDsdSidTabServiceId=17, DcmDsdSidTabSubfuncAvail=true  # Diagnostics Data Import
              Hard (DcmDsdSubService): DcmDsdSubServiceId=1  # Diagnostics Data Import
            DiagSessionControl: DcmDsdSidTabServiceId=16, DcmDsdSidTabSubfuncAvail=true  # Diagnostics Data Import
              3 x DcmDsdSubService:
                Extended: DcmDsdSubServiceId=3  # Diagnostics Data Import
                Programming: DcmDsdSubServiceId=2  # Diagnostics Data Import
                Default: DcmDsdSubServiceId=1  # Diagnostics Data Import
      DcmGeneral: DcmResetToFblAfterSessionFinalResponseEnabled=false  # Diagnostics Data Import
  module config Dem
    DemGeneral:  # Diagnostics Data Import
      DemOBDSupport = DEM_OBD_NO_OBD_SUPPORT
      DemAgingCycleCounterProcessing = DEM_PROCESS_AGINGCTR_INTERN
      DemDebounceCounterBasedSupport = true
      DemPTOSupport = false
      DemDtcStatusAvailabilityMask = 255
      4 x DemDataClass:
        OccurrenceCounter_Occurrence_Counter: DemDataElementDataSize=1, DemDataElementInternalData=DEM_OCCCTR, DemDataElementUsePort=USE_DATA_INTERNAL  # Diagnostics Data Import
        DID_0x1_DID_Data_GlobalTime: DemDataElementDataSize=6, DemDataElementDataType=UINT8_N, DemDataElementEndianness=opaque, DemDataElementUsePort=USE_DATA_CLIENT_SERVER_PORT, DemDataElementStoreNonVolatile=true  # Diagnostics Data Import
        PID_0x13_DID_Data: DemDataElementDataSize=2, DemDataElementDataType=UINT16, DemDataElementEndianness=BIG_ENDIAN, DemDataElementUsePort=USE_DATA_CLIENT_SERVER_PORT, DemDataElementStoreNonVolatile=true  # Diagnostics Data Import
        PID_0x12_DID_Data: DemDataElementDataSize=2, DemDataElementDataType=UINT16, DemDataElementEndianness=BIG_ENDIAN, DemDataElementUsePort=USE_DATA_CLIENT_SERVER_PORT, DemDataElementStoreNonVolatile=true  # Diagnostics Data Import
      4 x DemOperationCycle:
        WarmUpCycle: DemOperationCycleType=DEM_OPCYC_WARMUP  # Diagnostics Data Import
        PowerCycle: DemOperationCycleType=DEM_OPCYC_POWER  # Diagnostics Data Import
        OBDDrivingCycle: DemOperationCycleType=DEM_OPCYC_OBD_DCY  # Diagnostics Data Import
        IgnitionCycle: DemOperationCycleType=DEM_OPCYC_IGNITION  # Diagnostics Data Import
      WarningIndicator (DemIndicator)  # Diagnostics Data Import
      FreezeFrameClass_89a2d1a5 (DemFreezeFrameClass): DemDidClassRef=DemGeneral/Example_ReadOnlyDID, DemDidClassRef=DemGeneral/DID_0xF412, DemDidClassRef=DemGeneral/DID_0xF413  # Diagnostics Data Import
      FreezeFrameClass_7d61125a (DemFreezeFrameClass): DemDidClassRef=DemGeneral/Example_ReadOnlyDID  # Diagnostics Data Import
      OccurrenceCounter (DemExtendedDataRecordClass):  # Diagnostics Data Import
        DemExtendedDataRecordNumber = 1
        DemExtendedDataRecordTrigger = DEM_TRIGGER_ON_TEST_FAILED
        DemExtendedDataRecordUpdate = DEM_UPDATE_RECORD_NO
        DemDataClassRef = OccurrenceCounter_Occurrence_Counter
      ExtendedDataClass_83dcefb7 (DemExtendedDataClass): DemExtendedDataRecordClassRef=OccurrenceCounter  # Diagnostics Data Import
      3 x DemDidClass:
        DID_0xF413: DemDidIdentifier=62483, DemDidDataClassRef=PID_0x13_DID_Data  # Diagnostics Data Import
        DID_0xF412: DemDidIdentifier=62482, DemDidDataClassRef=PID_0x12_DID_Data  # Diagnostics Data Import
        Example_ReadOnlyDID: DemDidIdentifier=1, DemDidDataClassRef=DID_0x1_DID_Data_GlobalTime  # Diagnostics Data Import
      DemEventMemorySet  # Diagnostics Data Import
        PrimaryMemory (DemPrimaryMemory): DemTypeOfFreezeFrameRecordNumeration=DEM_FF_RECNUM_CALCULATED  # Diagnostics Data Import
    DemConfigSet  # Diagnostics Data Import
      DTC_0x000002_DebounceAlgorithmProperties (DemDebounceCounterBasedClass): DemDebounceCounterDecrementStepSize=1, DemDebounceCounterIncrementStepSize=1, DemDebounceCounterJumpDown=false, DemDebounceCounterJumpUp=true  # Diagnostics Data Import
      DTC_0x000003 (DemEventParameter):  # Diagnostics Data Import
        DemEventKind = DEM_EVENT_KIND_SWC
        DemMaxNumberFreezeFrameRecords = 1
        DemDTCClassRef = DTCClass_DTC_0x000003
        DemExtendedDataClassRef = ExtendedDataClass_83dcefb7
        DemFreezeFrameClassRef = FreezeFrameClass_89a2d1a5
        DemEventClass:  # Diagnostics Data Import
          DemAgingAllowed = true
          DemAgingCycleCounterThreshold = 40
          DemEventPriority = 1
          DemEventSignificance = DEM_EVENT_SIGNIFICANCE_FAULT
          DemEventFailureCycleCounterThreshold = 2
          DemAgingCycleRef = WarmUpCycle
          DemOperationCycleRef = OBDDrivingCycle
          IndicatorAttribute_WarningIndicator (DemIndicatorAttribute): DemIndicatorFailureCycleSource=DEM_FAILURE_CYCLE_EVENT, DemIndicatorHealingCycleRef=OBDDrivingCycle, DemIndicatorRef=WarningIndicator  # Diagnostics Data Import
        DemDebounceAlgorithmClass  # Diagnostics Data Import
          DemDebounceCounterBased: DemDebounceCounterBasedClassRef=DTC_0x000002_DebounceAlgorithmProperties  # Diagnostics Data Import
      DTCClass_DTC_0x000003 (DemDTCClass): DemDTCSeverity=DEM_DTC_SEV_NO_SEVERITY, DemUdsDTC=3, DemDTCAttributesRef=DtcAttributes_41914fb7  # Diagnostics Data Import
      DTC_0x000002 (DemEventParameter):  # Diagnostics Data Import
        DemEventKind = DEM_EVENT_KIND_SWC
        DemMaxNumberFreezeFrameRecords = 1
        DemDTCClassRef = DTCClass_DTC_0x000002
        DemExtendedDataClassRef = ExtendedDataClass_83dcefb7
        DemFreezeFrameClassRef = FreezeFrameClass_7d61125a
        DemEventClass:  # Diagnostics Data Import
          DemAgingAllowed = false
          DemAgingCycleCounterThreshold = 100
          DemEventPriority = 2
          DemEventSignificance = DEM_EVENT_SIGNIFICANCE_FAULT
          DemEventFailureCycleCounterThreshold = 0
          DemAgingCycleRef = IgnitionCycle
          DemOperationCycleRef = PowerCycle
          IndicatorAttribute_WarningIndicator (DemIndicatorAttribute): DemIndicatorFailureCycleSource=DEM_FAILURE_CYCLE_EVENT, DemIndicatorHealingCycleRef=PowerCycle, DemIndicatorRef=WarningIndicator  # Diagnostics Data Import
        DemCallbackInitMForE  # Diagnostics Data Import
        DemDebounceAlgorithmClass  # Diagnostics Data Import
          DemDebounceCounterBased: DemDebounceCounterBasedClassRef=DTC_0x000002_DebounceAlgorithmProperties  # Diagnostics Data Import
      DTCClass_DTC_0x000002 (DemDTCClass): DemDTCSeverity=DEM_DTC_SEV_NO_SEVERITY, DemUdsDTC=2, DemDTCAttributesRef=DtcAttributes_41914fb7  # Diagnostics Data Import
      DtcAttributes_41914fb7 (DemDTCAttributes): DemMemoryDestinationRef=PrimaryMemory  # Diagnostics Data Import
  module config EcuC
    EcucPduCollection: PduIdTypeEnum=UINT8, PduLengthTypeEnum=UINT8
      17 x Pdu:
        BFC_f09b214a_Rx: PduLength=8
        LightCtrl_oCAN00_0afee19e_Tx: DynamicLength=false, PduLength=8, SysTPduToFrameMappingRef=LightCtrl
        LightCtrl_oCAN00_2e88b3f5_Tx: DynamicLength=false, PduLength=8
        LightSwitch_oCAN00_8d4de26e_Rx: DynamicLength=false, PduLength=2, SysTPduToFrameMappingRef=LightSwitch
        LightSwitch_oCAN00_d3b6d56e_Rx: DynamicLength=false, PduLength=2
        Msg_Diag_Request_BFC_Tp_oCAN00_ebe478a8_Rx: DynamicLength=false, PduLength=8, SysTPduToFrameMappingRef=Msg_Diag_Request_BFC_Tp
        Msg_Diag_Request_BFC_oCAN00_7ad4193d_Rx: DynamicLength=true, PduLength=8
        Msg_Diag_Request_BFC_oCAN00_dced82e4_Rx: DynamicLength=true, PduLength=8
        Msg_Diag_Request_Global_Tp_oCAN00_eed4c6c0_Rx: DynamicLength=false, PduLength=8, SysTPduToFrameMappingRef=Msg_Diag_Request_Global_Tp
        Msg_Diag_Request_Global_oCAN00_4d90f286_Rx: DynamicLength=true, PduLength=7
        Msg_Diag_Request_Global_oCAN00_85e930b7_Rx: DynamicLength=true, PduLength=7
        Msg_Diag_Response_BFC_Tp_oCAN00_2e02c5db_Tx: DynamicLength=false, PduLength=8, SysTPduToFrameMappingRef=Msg_Diag_Response_BFC_Tp
        Msg_Diag_Response_BFC_oCAN00_61e49ee1_Tx: DynamicLength=true, PduLength=8
        Msg_Diag_Response_BFC_oCAN00_68c05815_Tx: DynamicLength=true, PduLength=8
        Msg_Diag_Uudt_Response_BFC_oCAN00_b52a569b_Tx: DynamicLength=true, PduLength=8, SysTPduToFrameMappingRef=Msg_Diag_Uudt_Response_BFC
        Msg_Diag_Uudt_Response_BFC_oCAN00_e0f86470_Tx: DynamicLength=true, PduLength=8
        NmBFC_oCAN00_4874935e_Tx: DynamicLength=false, PduLength=8, SysTPduToFrameMappingRef=NmBFC
  module config EcuM
    EcuMConfiguration
      EcuMCommonConfiguration
        EcuMDriverInitListOne
        EcuMDriverRestartList
        CN_CAN00_a2373004 (EcuMWakeupSource): EcuMWakeupSourceId=5, EcuMComMChannelRef=ComMConfigSet/CN_CAN00_a2373004
      EcuMFlexConfiguration: EcuMFlexModuleConfigurationRef=CanConfigSet
  module config Nm
    CN_CAN00_a2373004 (NmChannelConfig): NmComMChannelRef=ComMConfigSet/CN_CAN00_a2373004
      CAN00_CAN_5faa4e95 (NmBusType)
        NmStandardBusNmConfig: NmStandardBusType=NM_BUSNM_CANNM  # CAN00_CAN
    NmGlobalConfig
      NmGlobalFeatures: NmNodeIdEnabled=false, NmUserDataEnabled=true
      NmGlobalProperties
  module config PduR
    PduRGeneral
    PduRRoutingTables
      PduRRoutingTable
        6 x PduRRoutingPath:
          LightCtrl_oCAN00_2e88b3f5_Tx
            LightCtrl_oCAN00_0afee19e_Tx (PduRDestPdu): PduRDestPduRef=EcucPduCollection/LightCtrl_oCAN00_0afee19e_Tx
            PduRSrcPdu_30bff602 (PduRSrcPdu): PduRSrcPduRef=EcucPduCollection/LightCtrl_oCAN00_2e88b3f5_Tx
          LightSwitch_oCAN00_8d4de26e_Rx
            LightSwitch_oCAN00_8d4de26e_Rx_d73f9532_Rx (PduRDestPdu): PduRDestPduRef=EcucPduCollection/LightSwitch_oCAN00_d3b6d56e_Rx
            PduRSrcPdu_d73f9532 (PduRSrcPdu): PduRSrcPduRef=EcucPduCollection/LightSwitch_oCAN00_8d4de26e_Rx
          Msg_Diag_Request_BFC_oCAN00_7ad4193d_Rx
            Msg_Diag_Request_BFC_oCAN00_7ad4193d_Rx_4456ad7e_Rx (PduRDestPdu): PduRDestPduRef=Msg_Diag_Request_BFC_oCAN00_dced82e4_Rx
            PduRSrcPdu_4456ad7e (PduRSrcPdu): PduRSrcPduRef=EcucPduCollection/Msg_Diag_Request_BFC_oCAN00_7ad4193d_Rx
          Msg_Diag_Request_Global_oCAN00_4d90f286_Rx
            Msg_Diag_Request_Global_oCAN00_4d90f286_Rx_46121bfc_Rx (PduRDestPdu): PduRDestPduRef=Msg_Diag_Request_Global_oCAN00_85e930b7_Rx
            PduRSrcPdu_46121bfc (PduRSrcPdu): PduRSrcPduRef=EcucPduCollection/Msg_Diag_Request_Global_oCAN00_4d90f286_Rx
          Msg_Diag_Response_BFC_oCAN00_61e49ee1_Tx
            Msg_Diag_Response_BFC_oCAN00_68c05815_Tx (PduRDestPdu): PduRDestPduRef=EcucPduCollection/Msg_Diag_Response_BFC_oCAN00_68c05815_Tx
            PduRSrcPdu_07e648d9 (PduRSrcPdu): PduRSrcPduRef=EcucPduCollection/Msg_Diag_Response_BFC_oCAN00_61e49ee1_Tx
          Msg_Diag_Uudt_Response_BFC_oCAN00_e0f86470_Tx
            Msg_Diag_Uudt_Response_BFC_oCAN00_b52a569b_Tx (PduRDestPdu): PduRDestPduRef=EcucPduCollection/Msg_Diag_Uudt_Response_BFC_oCAN00_b52a569b_Tx
            PduRSrcPdu_52d88f71 (PduRSrcPdu): PduRSrcPduRef=EcucPduCollection/Msg_Diag_Uudt_Response_BFC_oCAN00_e0f86470_Tx
