AUTOSAR XML (schema 00049)
package /ActiveEcuC
  module config Can: implementation-config-variant=VARIANT-PRE-COMPILE, module-description=Can_Impl
    CanConfigSet
      CT_CAN00_6199f384 (CanController):
        CanControllerActivation = true
        CanBusoffProcessing = INTERRUPT
        CanControllerBaseAddress = 4028662272
        CanControllerId = 0
        CanRxProcessing = INTERRUPT
        CanTxProcessing = INTERRUPT
        CanWakeupProcessing = INTERRUPT
        CanWakeupSupport = false
        CanWakeupSourceId = 0
        CanIndividualProcessing = false
        CanFdSupport = NONE
        CanMaxRxDataLen = 8
        CanMaxTxDataLen = 8
        CanRamCheck = None
        CanControllerDefaultBaudrate = CanControllerBaudrateConfig
        CanControllerSystemRef = CT_CAN00
        CanWakeupSourceRef = CAN00_f26020e5
        CanCpuClockRef = McuClockReferencePoint_CAN
        CanvCanExtensionRef = vCanController
        CanOsCounterRef = SystemTimer
        CanControllerBaudrateConfig:
          CanControllerBaudRate = 500
          CanControllerBaudRateConfigID = 0
          CanControllerPropSeg = 5
          CanControllerSeg1 = 2
          CanControllerSeg2 = 2
          CanControllerSyncJumpWidth = 1
          CanBaudrateClock = 20000
          CanBaudratePrescaler = 4
        CanFilterMask:
          CanFilterMaskValue = 0
          CanFilterCodeValue = 0
          IsLocked = false
          CanFilterMaskId = 0
          CanFilterRangeLowerBound = 0
          CanFilterRangeUpperBound = 0
          CanFilterDualId1 = 0
          CanFilterDualId2 = 0
          CanFilterMode = CodeMask
          CanIsRejectionFilter = false
        CanFilterOptimizationSettings:
          CanFilterResourcesToBeUsed = 50
          CanFullCansToBeUsed = 50
          CanRangeFilterUsage = false
          CanDualIdFilterUsage = false
          CanRejectionFilterUsage = false
          CanModifyNumberOfFilters = false
          CanFilterSearchIntensity = MEDIUM
        CanFilterMask_001 (CanFilterMask):
          CanFilterMaskValue = 0
          CanFilterCodeValue = 0
          IsLocked = false
          CanFilterMaskId = 1
          CanFilterRangeLowerBound = 0
          CanFilterRangeUpperBound = 0
          CanFilterDualId1 = 0
          CanFilterDualId2 = 0
          CanFilterMode = CodeMask
          CanIsRejectionFilter = false
      3 x CanHardwareObject, all with CanHandleType=BASIC, CanIdType=STANDARD, CanIdValue=0, CanHwProcessing=false, CanMaxDataLen=8, CanFdPaddingValue=0, CanObjectMultiplexedTransmission=false, CanObjectHwFifo=false, CanControllerRef=CT_CAN00_6199f384:
        CN_CAN00_e8c1d35b_Rx_Std: CanObjectType=RECEIVE, CanObjectId=1, CanObjectHwSize=2, CanObjectHwHandle=0, CanFilterMaskRef=CanFilterMask
        CN_CAN00_a2373004_Tx: CanObjectType=TRANSMIT, CanObjectId=0, CanObjectHwSize=1, CanObjectHwHandle=0
        CN_CAN00_193527e3_Rx: CanObjectType=RECEIVE, CanObjectId=2, CanObjectHwSize=1, CanObjectHwHandle=1, CanFilterMaskRef=CanFilterMask_001
    CanGeneral:
      CanIndex = 0
      CanVersionInfoApi = true
      CanGetStatus = true
      CanChangeBaudrateApi = false
      CanDevErrorDetection = true
      CanHardwareCancellation = false
      CanIdenticalIdCancellation = false
      CanMainFunctionBusoffPeriod = 0.01
      CanMainFunctionModePeriod = 0.01
      CanMainFunctionWakeupPeriod = 0.01
      CanMultiplexedTransmission = false
      CanTimeoutDuration = 0.01
      CanGenericPrecopy = false
      CanHardwareCancelByAppl = false
      CanGenericConfirmationAPI2 = false
      CanRxQueue = false
      CanSupportMixedID = false
      CanSupportExtendedID = false
      CanRxQueueSize = 10
      CanHardwareHandleType = UINT8
      CanInterruptCategory = CATEGORY2
      CanInterruptLock = DRIVER
      CanOverrunNotification = None
      CanReinitStart = false
      CanGenericPreTransmit = false
      CanRuntimeMeasurementSupport = false
      CanUsePeripheralAccessApi = false
      CanUseOsInterruptControl = true
      CanSafeBswChecks = false
      CanCheckWakeupCanRetType = false
      CanFdHardwareBufferOptimization = true
      CanGenericConfirmation = None
      CanMirrorModeSupport = false
      CanSilentModeSupport = false
      CanHardwareLoopCheck = false
      CanEnableSecurityEventReporting = false
      CanSetBaudrateApi = true
      CanSoftwareCancellation = false
      CanRamCheck = None
      CanSupportMultipartition = false
      CanConstantDataToDefine = true
      CanCounterRef = SystemTimer
      CanMainFunctionRWPeriods
