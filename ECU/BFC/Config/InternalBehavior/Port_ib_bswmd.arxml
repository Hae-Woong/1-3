AUTOSAR XML (schema 00049)
package /AURIX2G/EcucDefs/Port_ib_bswmd/BswModuleDescriptions
  bsw module description Port
    bsw internal behavior PortBehavior
package /TS_T2D22M10I1R0/Port_ib_bswmd/BswModuleDescriptions
  bsw module description Port
    bsw internal behavior PortBehavior
      exclusive area PORT_EXCLUSIVE_AREA_00
      exclusive area PORT_EXCLUSIVE_AREA_01
package /TS_T2D22M10I0R0/Port_ib_bswmd/BswModuleDescriptions
  bsw module description Port
    bsw internal behavior PortBehavior
      exclusive area PORT_EXCLUSIVE_AREA_00
      exclusive area PORT_EXCLUSIVE_AREA_01
