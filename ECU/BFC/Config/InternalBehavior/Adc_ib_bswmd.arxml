AUTOSAR XML (schema 00049)
package /AURIX2G/EcucDefs/Adc_ib_bswmd/BswModuleDescriptions
  bsw module description Adc: provided-entrys=Adc_Virtual
    bsw internal behavior AdcBehavior
      exclusive area KernelData
      exclusive area SrcRegAccess
      bsw called entity Adc_Virtual: can-enter-exclusive-area=[KernelData, SrcRegAccess], implemented-entry=Adc_Virtual
  bsw module entry Adc_Virtual: call-type=REGULAR, execution-context=TASK
package /TS_T2D22M10I1R0/Adc_ib_bswmd/BswModuleDescriptions
  bsw module description Adc
    bsw internal behavior AdcBehavior
      27 x exclusive area:
        ADC_EXCLUSIVE_AREA_{00..26}
