AUTOSAR XML (schema 00049)
package /MICROSAR/vCan_30_Mcan_ib_bswmd/BswModuleDescriptions
  bsw module description vCan: provided-entrys=vCan_30_Mcan_Virtual
    bsw internal behavior vCan_30_McanBehavior
      exclusive area VCAN_30_MCAN_EXCLUSIVE_AREA_0
      exclusive area VCAN_30_MCAN_EXCLUSIVE_AREA_1
      bsw called entity vCan_30_Mcan_Virtual: can-enter-exclusive-area=[VCAN_30_MCAN_EXCLUSIVE_AREA_0, VCAN_30_MCAN_EXCLUSIVE_AREA_1], implemented-entry=vCan_30_Mcan_Virtual
  bsw module entry vCan_30_Mcan_Virtual: call-type=REGULAR, execution-context=TASK
