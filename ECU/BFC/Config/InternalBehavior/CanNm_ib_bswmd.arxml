AUTOSAR XML (schema 00049)
package /MICROSAR
  bsw implementation CanNm_Impl: programming-language=C, sw-version=11.00.01, used-code-generator=DaVinci Configurator, vendor-id=30, ar-release-version=4.00.03
