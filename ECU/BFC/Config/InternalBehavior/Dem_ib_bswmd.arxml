AUTOSAR XML (schema 00049)
package /MICROSAR
  bsw implementation Dem_Impl: programming-language=C, sw-version=27.00.00, used-code-generator=DaVinci Configurator, vendor-id=30, ar-release-version=4.01.02
    resource consumption ResourceConsumption
      76 x memory section:
        CODE: sw-addrmethod=CODE
        CONST_16: alignment=16, sw-addrmethod=CONST
        CONST_32: alignment=32, sw-addrmethod=CONST
        CONST_64: alignment=64, sw-addrmethod=CONST
        CONST_8: alignment=8, sw-addrmethod=CONST
        CONST_BOOLEAN: alignment=BOOLEAN, sw-addrmethod=CONST
        CONST_UNSPECIFIED: alignment=UNSPECIFIED, sw-addrmethod=CONST
        DEM_INVALID_OSAPPLICATION_VAR_CLEARED_UNSPECIFIED: alignment=UNSPECIFIED, sw-addrmethod=VAR_CLEARED, symbol=INVALID_OSAPPLICATION_VAR_CLEARED_UNSPECIFIED
        VAR_CLEARED_16: alignment=16, sw-addrmethod=VAR_CLEARED
        VAR_CLEARED_32: alignment=32, sw-addrmethod=VAR_CLEARED
        VAR_CLEARED_64: alignment=64, sw-addrmethod=VAR_CLEARED
        VAR_CLEARED_8: alignment=8, sw-addrmethod=VAR_CLEARED
        VAR_CLEARED_BOOLEAN: alignment=BOOLEAN, sw-addrmethod=VAR_CLEARED
        VAR_CLEARED_UNSPECIFIED: alignment=UNSPECIFIED, sw-addrmethod=VAR_CLEARED
        VAR_FAST_CLEARED_16: alignment=16, sw-addrmethod=VAR_FAST_CLEARED
        VAR_FAST_CLEARED_32: alignment=32, sw-addrmethod=VAR_FAST_CLEARED
        VAR_FAST_CLEARED_64: alignment=64, sw-addrmethod=VAR_FAST_CLEARED
        VAR_FAST_CLEARED_8: alignment=8, sw-addrmethod=VAR_FAST_CLEARED
        VAR_FAST_CLEARED_BOOLEAN: alignment=BOOLEAN, sw-addrmethod=VAR_FAST_CLEARED
        VAR_FAST_CLEARED_UNSPECIFIED: alignment=UNSPECIFIED, sw-addrmethod=VAR_FAST_CLEARED
        VAR_FAST_INIT_16: alignment=16, sw-addrmethod=VAR_FAST_INIT
        VAR_FAST_INIT_32: alignment=32, sw-addrmethod=VAR_FAST_INIT
        VAR_FAST_INIT_64: alignment=64, sw-addrmethod=VAR_FAST_INIT
        VAR_FAST_INIT_8: alignment=8, sw-addrmethod=VAR_FAST_INIT
        VAR_FAST_INIT_BOOLEAN: alignment=BOOLEAN, sw-addrmethod=VAR_FAST_INIT
        VAR_FAST_INIT_UNSPECIFIED: alignment=UNSPECIFIED, sw-addrmethod=VAR_FAST_INIT
        VAR_FAST_NO_INIT_16: alignment=16, sw-addrmethod=VAR_FAST_NO_INIT
        VAR_FAST_NO_INIT_32: alignment=32, sw-addrmethod=VAR_FAST_NO_INIT
        VAR_FAST_NO_INIT_64: alignment=64, sw-addrmethod=VAR_FAST_NO_INIT
        VAR_FAST_NO_INIT_8: alignment=8, sw-addrmethod=VAR_FAST_NO_INIT
        VAR_FAST_NO_INIT_BOOLEAN: alignment=BOOLEAN, sw-addrmethod=VAR_FAST_NO_INIT
        VAR_FAST_NO_INIT_UNSPECIFIED: alignment=UNSPECIFIED, sw-addrmethod=VAR_FAST_NO_INIT
        VAR_INIT_16: alignment=16, sw-addrmethod=VAR_INIT
        VAR_INIT_32: alignment=32, sw-addrmethod=VAR_INIT
        VAR_INIT_64: alignment=64, sw-addrmethod=VAR_INIT
        VAR_INIT_8: alignment=8, sw-addrmethod=VAR_INIT
        VAR_INIT_8_RESTRICTED: alignment=8, sw-addrmethod=VAR_INIT
        VAR_INIT_BOOLEAN: alignment=BOOLEAN, sw-addrmethod=VAR_INIT
        VAR_INIT_UNSPECIFIED: alignment=UNSPECIFIED, sw-addrmethod=VAR_INIT
        VAR_NOCACHE_CLEARED_16: alignment=16, sw-addrmethod=VAR_NOCACHE_CLEARED
        VAR_NOCACHE_CLEARED_32: alignment=32, sw-addrmethod=VAR_NOCACHE_CLEARED
        VAR_NOCACHE_CLEARED_64: alignment=64, sw-addrmethod=VAR_NOCACHE_CLEARED
        VAR_NOCACHE_CLEARED_8: alignment=8, sw-addrmethod=VAR_NOCACHE_CLEARED
        VAR_NOCACHE_CLEARED_BOOLEAN: alignment=BOOLEAN, sw-addrmethod=VAR_NOCACHE_CLEARED
        VAR_NOCACHE_CLEARED_UNSPECIFIED: alignment=UNSPECIFIED, sw-addrmethod=VAR_NOCACHE_CLEARED
        VAR_NOCACHE_INIT_16: alignment=16, sw-addrmethod=VAR_NOCACHE_INIT
        VAR_NOCACHE_INIT_32: alignment=32, sw-addrmethod=VAR_NOCACHE_INIT
        VAR_NOCACHE_INIT_64: alignment=64, sw-addrmethod=VAR_NOCACHE_INIT
        VAR_NOCACHE_INIT_8: alignment=8, sw-addrmethod=VAR_NOCACHE_INIT
        VAR_NOCACHE_INIT_BOOLEAN: alignment=BOOLEAN, sw-addrmethod=VAR_NOCACHE_INIT
        VAR_NOCACHE_INIT_UNSPECIFIED: alignment=UNSPECIFIED, sw-addrmethod=VAR_NOCACHE_INIT
        VAR_NOCACHE_NO_INIT_16: alignment=16, sw-addrmethod=VAR_NOCACHE_NO_INIT
        VAR_NOCACHE_NO_INIT_32: alignment=32, sw-addrmethod=VAR_NOCACHE_NO_INIT
        VAR_NOCACHE_NO_INIT_64: alignment=64, sw-addrmethod=VAR_NOCACHE_NO_INIT
        VAR_NOCACHE_NO_INIT_8: alignment=8, sw-addrmethod=VAR_NOCACHE_NO_INIT
        VAR_NOCACHE_NO_INIT_BOOLEAN: alignment=BOOLEAN, sw-addrmethod=VAR_NOCACHE_NO_INIT
        VAR_NOCACHE_NO_INIT_UNSPECIFIED: alignment=UNSPECIFIED, sw-addrmethod=VAR_NOCACHE_NO_INIT
        VAR_NOCACHE_SAVED_ZONE0_16: alignment=16, sw-addrmethod=VAR_SAVED_ZONE
        VAR_NOCACHE_SAVED_ZONE0_32: alignment=32, sw-addrmethod=VAR_SAVED_ZONE
        VAR_NOCACHE_SAVED_ZONE0_64: alignment=64, sw-addrmethod=VAR_SAVED_ZONE
        VAR_NOCACHE_SAVED_ZONE0_8: alignment=8, sw-addrmethod=VAR_SAVED_ZONE
        VAR_NOCACHE_SAVED_ZONE0_BOOLEAN: alignment=BOOLEAN, sw-addrmethod=VAR_SAVED_ZONE
        VAR_NOCACHE_SAVED_ZONE0_UNSPECIFIED: alignment=UNSPECIFIED, sw-addrmethod=VAR_SAVED_ZONE
        VAR_NO_INIT_16: alignment=16, sw-addrmethod=VAR_NO_INIT
        VAR_NO_INIT_32: alignment=32, sw-addrmethod=VAR_NO_INIT
        VAR_NO_INIT_64: alignment=64, sw-addrmethod=VAR_NO_INIT
        VAR_NO_INIT_8: alignment=8, sw-addrmethod=VAR_NO_INIT
        VAR_NO_INIT_BOOLEAN: alignment=BOOLEAN, sw-addrmethod=VAR_NO_INIT
        VAR_NO_INIT_UNSPECIFIED: alignment=UNSPECIFIED, sw-addrmethod=VAR_NO_INIT
        VAR_NO_INIT_UNSPECIFIED_RESTRICTED: alignment=UNSPECIFIED, sw-addrmethod=VAR_NO_INIT
        VAR_SAVED_ZONE0_16: alignment=16, sw-addrmethod=VAR_SAVED_ZONE
        VAR_SAVED_ZONE0_32: alignment=32, sw-addrmethod=VAR_SAVED_ZONE
        VAR_SAVED_ZONE0_64: alignment=64, sw-addrmethod=VAR_SAVED_ZONE
        VAR_SAVED_ZONE0_8: alignment=8, sw-addrmethod=VAR_SAVED_ZONE
        VAR_SAVED_ZONE0_BOOLEAN: alignment=BOOLEAN, sw-addrmethod=VAR_SAVED_ZONE
        VAR_SAVED_ZONE0_UNSPECIFIED: alignment=UNSPECIFIED, sw-addrmethod=VAR_SAVED_ZONE
package /MICROSAR/Dem_ib_bswmd/BswModuleDescriptions
  bsw module description Dem: provided-entrys=[Dem_MasterMainFunction, Dem_SatelliteMainFunction]
    bsw internal behavior DemBehavior
      5 x exclusive area:
        DEM_EXCLUSIVE_AREA_0  # (DiagMonitor) Ensures consistency and atomicity of event reports
        DEM_EXCLUSIVE_AREA_1  # (StateManager) Ensures consistent status updates when receiving ECU states managed outside the Dem
        DEM_EXCLUSIVE_AREA_2  # (DcmAPI) Ensures consistent status updates when receiving ECU states managed outside the Dem
        DEM_EXCLUSIVE_AREA_3  # (CrossCoreComm) Ensures consistent prestorage when called from multiple clients. Ensures data consistency between satellites and master if the platform does not provide a specific compareAndSwap instruction
        DEM_EXCLUSIVE_AREA_4  # (NonAtomic32bit) Ensures consistency if the platform does not provide an atomic 32bit access
      bsw schedulable entity Dem_MasterMainFunction: can-enter-exclusive-area=[DEM_EXCLUSIVE_AREA_0, DEM_EXCLUSIVE_AREA_1, DEM_EXCLUSIVE_AREA_2, DEM_EXCLUSIVE_AREA_3, DEM_EXCLUSIVE_AREA_4], implemented-entry=Dem_MasterMainFunction
      bsw schedulable entity Dem_SatelliteMainFunction: can-enter-exclusive-area=[DEM_EXCLUSIVE_AREA_0, DEM_EXCLUSIVE_AREA_1, DEM_EXCLUSIVE_AREA_2, DEM_EXCLUSIVE_AREA_3, DEM_EXCLUSIVE_AREA_4], implemented-entry=Dem_SatelliteMainFunction
      bsw timing event Dem_MasterMainFunctionTimingEvent0: starts-on-event=Dem_MasterMainFunction, period=0.01
      bsw timing event Dem_SatelliteMainFunctionTimingEvent0: starts-on-event=Dem_SatelliteMainFunction, period=0.01
  bsw module entry Dem_MasterMainFunction: call-type=SCHEDULED, execution-context=TASK
  bsw module entry Dem_SatelliteMainFunction: call-type=SCHEDULED, execution-context=TASK
