AUTOSAR XML (schema 00049)
package /MICROSAR
  bsw implementation Rte_Impl: programming-language=C, sw-version=4.37.00, used-code-generator=DaVinci Configurator, vendor-id=30, ar-release-version=4.03.01
    resource consumption ResourceConsumption
      25 x memory section:
        CODE: sw-addrmethod=CODE
        VAR_NOINIT_UNSPECIFIED: sw-addrmethod=VAR_NO_INIT
        VAR_ZERO_INIT_UNSPECIFIED: sw-addrmethod=VAR_CLEARED
        VAR_ZERO_INIT_8BIT: sw-addrmethod=VAR_CLEARED
        VAR_INIT_UNSPECIFIED: sw-addrmethod=VAR_INIT
        CONST_UNSPECIFIED: sw-addrmethod=CONST
        APPL_CODE: sw-addrmethod=CODE
        BSWM_APPL_CODE: sw-addrmethod=CODE
        BSW_HANDLER_APPL_CODE: sw-addrmethod=CODE
        COMM_APPL_CODE: sw-addrmethod=CODE
        DET_APPL_CODE: sw-addrmethod=CODE
        ECUM_APPL_CODE: sw-addrmethod=CODE
        IOHWAB_APPL_CODE: sw-addrmethod=CODE
        LIGHTCTRL_APPL_CODE: sw-addrmethod=CODE
        BSWTASK_CODE: sw-addrmethod=CODE
        IDLETASK_OSCORE_CODE: sw-addrmethod=CODE
        IOTASK_CODE: sw-addrmethod=CODE
        SWCTASK_CODE: sw-addrmethod=CODE
        DEMMASTER_INVALID_OSAPPLICATION_APPL_CODE: sw-addrmethod=CODE
        DEMSATELLITE_INVALID_OSAPPLICATION_APPL_CODE: sw-addrmethod=CODE
        OS_OSCORE_SWC_APPL_CODE: sw-addrmethod=CODE
        DEFAULT_INIT_TASK_CODE: sw-addrmethod=CODE
        DEFAULT_INIT_TASK_TRUSTED_CODE: sw-addrmethod=CODE
        DCM_APPL_CODE: sw-addrmethod=CODE
        NVM_APPL_CODE: sw-addrmethod=CODE
package /MICROSAR/Rte_ib_bswmd/BswModuleDescriptions
  bsw module description Rte
    bsw internal behavior RteBehavior
