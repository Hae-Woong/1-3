AUTOSAR XML (schema 00049)
package /AURIX2G/EcucDefs/Irq_ib_bswmd/BswModuleDescriptions
  bsw module description Irq
    bsw internal behavior IrqBehavior
