AUTOSAR XML (schema 00049)
package /MICROSAR
  bsw implementation Com_Impl: programming-language=C, sw-version=25.02.00, used-code-generator=DaVinci Configurator, vendor-id=30, ar-release-version=4.00.03, behavior=ComBehavior
  bsw implementation EcuM_Impl: programming-language=C, sw-version=15.00.01, used-code-generator=DaVinci Configurator, vendor-id=30, ar-release-version=4.00.03, behavior=EcuMBehavior
  bsw implementation PduR_Impl: programming-language=C, sw-version=18.03.02, used-code-generator=DaVinci Configurator, vendor-id=30, ar-release-version=4.01.02, behavior=PduRBehavior
package /MICROSAR/Com_ib_bswmd/BswModuleDescriptions
  bsw module description Com
    bsw internal behavior ComBehavior
      exclusive area COM_EXCLUSIVE_AREA_TX  # This critical section protects Tx ressources that can be accessed from various contexts. Therefore the critical section enclosed with COM_EXCLUSIVE_AREA_TX should never be interrupted by any Com API which accesses Tx ressources. For more details, see DocTechRef.
      exclusive area COM_EXCLUSIVE_AREA_RX  # This critical section protects Rx ressources that can be accessed from various contexts.Therefore the critical section enclosed with COM_EXCLUSIVE_AREA_RX should never be interrupted by any Com API which accesses Rx ressources. For more details, see DocTechRef.
      exclusive area COM_EXCLUSIVE_AREA_BOTH  # This critical section protects Rx and Tx ressources that are being accessed in context of Com_MainFunctionRouteSignals for signal gateway routings or description routings with configured deferred description source. For more details, see DocTechRef.
      bsw schedulable entity Com_MainFunctionTx_ComMainFunctionTx: can-enter-exclusive-area=[COM_EXCLUSIVE_AREA_TX, COM_EXCLUSIVE_AREA_RX, COM_EXCLUSIVE_AREA_BOTH], implemented-entry=Com_MainFunctionTx_ComMainFunctionTx
      bsw schedulable entity Com_MainFunctionRx_ComMainFunctionRx: can-enter-exclusive-area=[COM_EXCLUSIVE_AREA_TX, COM_EXCLUSIVE_AREA_RX, COM_EXCLUSIVE_AREA_BOTH], implemented-entry=Com_MainFunctionRx_ComMainFunctionRx
      bsw timing event Com_MainFunctionTx_ComMainFunctionTxTimingEvent0: starts-on-event=Com_MainFunctionTx_ComMainFunctionTx, period=0.01
      bsw timing event Com_MainFunctionRx_ComMainFunctionRxTimingEvent0: starts-on-event=Com_MainFunctionRx_ComMainFunctionRx, period=0.01
  bsw module entry Com_MainFunctionTx_ComMainFunctionTx: call-type=SCHEDULED, execution-context=TASK
  bsw module entry Com_MainFunctionRx_ComMainFunctionRx: call-type=SCHEDULED, execution-context=TASK
package /MICROSAR/EcuM_ib_bswmd/BswModuleDescriptions
  bsw module description EcuM
    bsw internal behavior EcuMBehavior
      4 x exclusive area:
        ECUM_EXCLUSIVE_AREA_0  # This exclusive area shall disable all wake up interrupts to prevent overwriting of some global variables.
        ECUM_EXCLUSIVE_AREA_1  # This exclusive area is only used in case of multi core and if the the EcuM is configured to handle also the slave cores. It must be configured as a spinlock to allow access to some variables simultaneously from multiple cores.
        ECUM_EXCLUSIVE_AREA_2  # This exclusive area is used for accessing the clock variable. It shall disable GPT interrupts and task changes. Only necessary if 32 Bit access is not atomic and Alarm Clock is present.
        ECUM_EXCLUSIVE_AREA_3  # This This exclusive area must be configured as a spin lock to protect access on global shutdown target variables.
      bsw schedulable entity EcuM_MainFunction: can-enter-exclusive-area=[ECUM_EXCLUSIVE_AREA_0, ECUM_EXCLUSIVE_AREA_1, ECUM_EXCLUSIVE_AREA_2, ECUM_EXCLUSIVE_AREA_3], implemented-entry=EcuM_MainFunction
      bsw timing event EcuM_MainFunctionTimingEvent0: starts-on-event=EcuM_MainFunction, period=0.01
  bsw module entry EcuM_MainFunction: call-type=SCHEDULED, execution-context=TASK
package /MICROSAR/PduR_ib_bswmd/BswModuleDescriptions
  bsw module description PduR
    bsw internal behavior PduRBehavior
      exclusive area PDUR_EXCLUSIVE_AREA_0
      bsw called entity PduR_Virtual: can-enter-exclusive-area=PDUR_EXCLUSIVE_AREA_0, implemented-entry=PduR_Virtual
  bsw module entry PduR_Virtual: call-type=REGULAR, execution-context=TASK
